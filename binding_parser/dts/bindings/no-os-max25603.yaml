## binding_parser/dts/bindings/no-os-max25603.yaml
```yaml
# Copyright (c) 2025 Analog Devices Inc.

description: No-os binding for max25603 device

compatible: "adi,no-os-max25603"

include: [gpio-controller.yaml]

properties:
```

## binding_parser/dts/bindings/no-os-max31343.yaml
```yaml
# Copyright (c) 2025 Analog Devices Inc.

description: No-os binding for max31343 device

compatible: "adi,no-os-max31343"

include: [i2c-device.yaml]

properties:
  battery_en:
    type: uint8_t
```

## binding_parser/dts/bindings/no-os-max31827.yaml
```yaml
# Copyright (c) 2025 Analog Devices Inc.

description: No-os binding for max31827 device

compatible: "adi,no-os-max31827"

include: [i2c-device.yaml]

properties:
  comp_int:
    type: bool
  alarm_pol:
    type: bool
  fault_q:
    type: uint8_t
  timeout_enable:
    type: bool
```

## binding_parser/dts/bindings/no-os-max31827_iio.yaml
```yaml
# Copyright (c) 2025 Analog Devices Inc.

description: No-os binding for max31827_iio device

compatible: "adi,no-os-max31827_iio"


properties:
```

## binding_parser/dts/bindings/no-os-max31855.yaml
```yaml
# Copyright (c) 2025 Analog Devices Inc.

description: No-os binding for max31855 device

compatible: "adi,no-os-max31855"

include: [spi-device.yaml]

properties:
```

## binding_parser/dts/bindings/no-os-max31855_iio_dev.yaml
```yaml
# Copyright (c) 2025 Analog Devices Inc.

description: No-os binding for max31855_iio_dev device

compatible: "adi,no-os-max31855_iio_dev"


properties:
```

## binding_parser/dts/bindings/no-os-max31865.yaml
```yaml
# Copyright (c) 2025 Analog Devices Inc.

description: No-os binding for max31865 device

compatible: "adi,no-os-max31865"

include: [spi-device.yaml]

properties:
  rtd_rc:
    type: float
```

## binding_parser/dts/bindings/no-os-max31875.yaml
```yaml
# Copyright (c) 2025 Analog Devices Inc.

description: No-os binding for max31875 device

compatible: "adi,no-os-max31875"

include: [i2c-device.yaml]

properties:
```

## binding_parser/dts/bindings/no-os-max42500.yaml
```yaml
# Copyright (c) 2025 Analog Devices Inc.

description: No-os binding for max42500 device

compatible: "adi,no-os-max42500"

include: [i2c-device.yaml, gpio-controller.yaml]

properties:
  addr_sel:
    type: uint8_t
  pece:
    type: uint8_t
  vmon_en:
    type: uint8_t
  vmon_vmpd:
    type: uint8_t
  reset_map:
    type: uint8_t
  wd_mode:
    type: int
    enum:
      - MAX42500_WD_MODE_CH_RESP
      - MAX42500_WD_MODE_SIMPLE
      - MAX42500_WD_MODE_MAX
  wd_cdiv:
    type: uint8_t
  wd_close:
    type: uint8_t
  wd_open:
    type: uint8_t
  wd_1ud:
    type: uint8_t
  wd_en:
    type: uint8_t
```

## binding_parser/dts/bindings/no-os-max538x.yaml
```yaml
# Copyright (c) 2025 Analog Devices Inc.

description: No-os binding for max538x device

compatible: "adi,no-os-max538x"

include: [i2c-device.yaml]

properties:
  active_device:
    type: int
    enum:
      - MAX5380L
      - MAX5380M
      - MAX5380N
      - MAX5380K
      - MAX5381L
      - MAX5381M
      - MAX5381N
      - MAX5381K
      - MAX5382L
      - MAX5382M
      - MAX5382N
      - MAX5382K
```

## binding_parser/dts/bindings/no-os-max9611.yaml
```yaml
# Copyright (c) 2025 Analog Devices Inc.

description: No-os binding for max9611 device

compatible: "adi,no-os-max9611"

include: [i2c-device.yaml]

properties:
```

## binding_parser/dts/bindings/no-os-mdio_bitbang.yaml
```yaml
# Copyright (c) 2025 Analog Devices Inc.

description: No-os binding for mdio_bitbang device

compatible: "adi,no-os-mdio_bitbang"

include: [gpio-controller.yaml]

properties:
```

## binding_parser/dts/bindings/no-os-nhd_c12832a1z.yaml
```yaml
# Copyright (c) 2025 Analog Devices Inc.

description: No-os binding for nhd_c12832a1z device

compatible: "adi,no-os-nhd_c12832a1z"

include: [spi-device.yaml, gpio-controller.yaml]

properties:
```

## binding_parser/dts/bindings/no-os-pcf85263.yaml
```yaml
# Copyright (c) 2025 Analog Devices Inc.

description: No-os binding for pcf85263 device

compatible: "adi,no-os-pcf85263"

include: [i2c-device.yaml]

properties:
  battery_en:
    type: uint8_t
```

## binding_parser/dts/bindings/no-os-pulsar_adc.yaml
```yaml
# Copyright (c) 2025 Analog Devices Inc.

description: No-os binding for pulsar_adc device

compatible: "adi,no-os-pulsar_adc"

include: [spi-device.yaml, gpio-controller.yaml]

properties:
  axi_clkgen_rate:
    type: uint32_t
  reg_access_speed:
    type: uint32_t
  dev_id:
    type: int
    enum:
      - ID_AD4000
      - ID_AD4001
      - ID_AD4002
      - ID_AD4003
      - ID_AD4004
      - ID_AD4005
      - ID_AD4006
      - ID_AD4007
      - ID_AD4008
      - ID_AD4010
      - ID_AD4011
      - ID_AD4020
      - ID_AD4021
      - ID_AD4022
      - ID_ADAQ4003
      - ID_AD7690
      - ID_AD7691
      - ID_AD7693
      - ID_AD7942
      - ID_AD7944
      - ID_AD7946
      - ID_AD7980
      - ID_AD7982
      - ID_AD7983
      - ID_AD7984
      - ID_AD7985
      - ID_AD7986
  buffer_size:
    type: uint32_t
  offload_enable:
    type: bool
  turbo_mode:
    type: bool
  high_z_mode:
    type: bool
  span_compression:
    type: bool
  en_status_bits:
    type: bool
```

## binding_parser/dts/bindings/no-os-pulsar_adc_iio.yaml
```yaml
# Copyright (c) 2025 Analog Devices Inc.

description: No-os binding for pulsar_adc_iio device

compatible: "adi,no-os-pulsar_adc_iio"


properties:
  ref_voltage_mv:
    type: uint32_t
```

## binding_parser/dts/bindings/no-os-sd.yaml
```yaml
# Copyright (c) 2025 Analog Devices Inc.

description: No-os binding for sd device

compatible: "adi,no-os-sd"


properties:
```

## binding_parser/dts/bindings/no-os-spi_engine.yaml
```yaml
# Copyright (c) 2025 Analog Devices Inc.

description: No-os binding for spi_engine device

compatible: "adi,no-os-spi_engine"


properties:
  ref_clk_hz:
    type: uint32_t
  type:
    type: enum xil_spi_type
  spi_engine_baseaddr:
    type: uint32_t
  cs_delay:
    type: uint32_t
  data_width:
    type: uint8_t
  sdo_idle_state:
    type: uint8_t
```

## binding_parser/dts/bindings/no-os-spi_engine_offload.yaml
```yaml
# Copyright (c) 2025 Analog Devices Inc.

description: No-os binding for spi_engine_offload device

compatible: "adi,no-os-spi_engine_offload"


properties:
  rx_dma_baseaddr:
    type: uint32_t
  tx_dma_baseaddr:
    type: uint32_t
  dma_flags:
    type: uint32_t
  offload_config:
    type: uint8_t
```

## binding_parser/dts/bindings/no-os-tmc7300.yaml
```yaml
# Copyright (c) 2025 Analog Devices Inc.

description: No-os binding for tmc7300 device

compatible: "adi,no-os-tmc7300"


properties:
  addr:
    type: uint32_t
  parallel_mode:
    type: bool
```
