## binding_parser/dts/bindings/no-os-ltm4686.yaml
```yaml
# Copyright (c) 2025 Analog Devices Inc.

description: No-os binding for ltm4686 device

compatible: "adi,no-os-ltm4686"

include: [i2c-device.yaml, gpio-controller.yaml]

properties:
  id:
    type: int
    enum:
      - ID_LTM4686
      - ID_LTM4686B
      - ID_LTM4673
  external_clk_en:
    type: bool
  crc_en:
    type: bool
```

## binding_parser/dts/bindings/no-os-ltm4686_iio_desc.yaml
```yaml
# Copyright (c) 2025 Analog Devices Inc.

description: No-os binding for ltm4686_iio_desc device

compatible: "adi,no-os-ltm4686_iio_desc"


properties:
```

## binding_parser/dts/bindings/no-os-ltp8800.yaml
```yaml
# Copyright (c) 2025 Analog Devices Inc.

description: No-os binding for ltp8800 device

compatible: "adi,no-os-ltp8800"

include: [i2c-device.yaml, gpio-controller.yaml]

properties:
  write_protect_en:
    type: bool
  external_clk_en:
    type: bool
  sync_en:
    type: bool
  crc_en:
    type: bool
  polyphase_order:
    type: uint8_t
```

## binding_parser/dts/bindings/no-os-ltp8800_iio_desc.yaml
```yaml
# Copyright (c) 2025 Analog Devices Inc.

description: No-os binding for ltp8800_iio_desc device

compatible: "adi,no-os-ltp8800_iio_desc"


properties:
```

## binding_parser/dts/bindings/no-os-max11205.yaml
```yaml
# Copyright (c) 2025 Analog Devices Inc.

description: No-os binding for max11205 device

compatible: "adi,no-os-max11205"

include: [spi-device.yaml, gpio-controller.yaml]

properties:
  vref_mv:
    type: uint32_t
```

## binding_parser/dts/bindings/no-os-max11205_iio_dev.yaml
```yaml
# Copyright (c) 2025 Analog Devices Inc.

description: No-os binding for max11205_iio_dev device

compatible: "adi,no-os-max11205_iio_dev"


properties:
  dev_id:
    type: int
    enum:
      - MAX11205A
      - MAX11205B
```

## binding_parser/dts/bindings/no-os-max14001.yaml
```yaml
# Copyright (c) 2025 Analog Devices Inc.

description: No-os binding for max14001 device

compatible: "adi,no-os-max14001"

include: [spi-device.yaml]

properties:
```

## binding_parser/dts/bindings/no-os-max14906_iio_desc.yaml
```yaml
# Copyright (c) 2025 Analog Devices Inc.

description: No-os binding for max14906_iio_desc device

compatible: "adi,no-os-max14906_iio_desc"


properties:
```

## binding_parser/dts/bindings/no-os-max14914.yaml
```yaml
# Copyright (c) 2025 Analog Devices Inc.

description: No-os binding for max14914 device

compatible: "adi,no-os-max14914"

include: [gpio-controller.yaml]

properties:
```

## binding_parser/dts/bindings/no-os-max14916_iio_desc.yaml
```yaml
# Copyright (c) 2025 Analog Devices Inc.

description: No-os binding for max14916_iio_desc device

compatible: "adi,no-os-max14916_iio_desc"


properties:
  ch_enable[MAX14916_CHANNELS]:
    type: bool
```

## binding_parser/dts/bindings/no-os-max14919.yaml
```yaml
# Copyright (c) 2025 Analog Devices Inc.

description: No-os binding for max14919 device

compatible: "adi,no-os-max14919"

include: [gpio-controller.yaml]

properties:
```

## binding_parser/dts/bindings/no-os-max149x6.yaml
```yaml
# Copyright (c) 2025 Analog Devices Inc.

description: No-os binding for max149x6 device

compatible: "adi,no-os-max149x6"

include: [spi-device.yaml, gpio-controller.yaml]

properties:
  chip_address:
    type: uint32_t
  crc_en:
    type: bool
```

## binding_parser/dts/bindings/no-os-max17851.yaml
```yaml
# Copyright (c) 2025 Analog Devices Inc.

description: No-os binding for max17851 device

compatible: "adi,no-os-max17851"

include: [spi-device.yaml, gpio-controller.yaml]

properties:
  comm_to_delay:
    type: int
    enum:
      - MAX17851_TIMEOUT_DELAY_276BITS
      - MAX17851_TIMEOUT_DELAY_516BITS
      - MAX17851_TIMEOUT_DELAY_996BITS
      - MAX17851_TIMEOUT_DELAY_1956BITS
      - MAX17851_TIMEOUT_DELAY_DISABLED
  safemon_dly:
    type: int
    enum:
      - MAX17851_SAFEMON_DLY_500MS
      - MAX17851_SAFEMON_DLY_1000MS
      - MAX17851_SAFEMON_DLY_1500MS
  op_mode:
    type: int
    enum:
      - MAX17851_SLAVE_DUAL_UART
      - MAX17851_MASTER_SINGLE_UART 
      - MAX17851_MASTER_DUAL_UART
  dbnc:
    type: int
    enum:
      - MAX17851_ALERTPCKT_DBNC_1
      - MAX17851_ALERTPCKT_DBNC_2
      - MAX17851_ALERTPCKT_DBNC_4
      - MAX17851_ALERTPCKT_DBNC_8
      - MAX17851_ALERTPCKT_DBNC_16
      - MAX17851_ALERTPCKT_DBNC_32
      - MAX17851_ALERTPCKT_DBNC_64
      - MAX17851_ALERTPCKT_DBNC_128
  baud_rate:
    type: int
    enum:
      - MAX17851_UART_BAUD_500K 
      - MAX17851_UART_BAUD_1M
      - MAX17851_UART_BAUD_2M
  contact_tmr_dly_4xmin:
    type: uint8_t
  gpio_rec_dly_csec:
    type: uint8_t
  no_dev:
    type: uint8_t
  single:
    type: bool
```

## binding_parser/dts/bindings/no-os-max22017.yaml
```yaml
# Copyright (c) 2025 Analog Devices Inc.

description: No-os binding for max22017 device

compatible: "adi,no-os-max22017"

include: [spi-device.yaml, gpio-controller.yaml]

properties:
  crc_en:
    type: bool
  ext_dac_ref:
    type: bool
```

## binding_parser/dts/bindings/no-os-max22017_gpio.yaml
```yaml
# Copyright (c) 2025 Analog Devices Inc.

description: No-os binding for max22017_gpio device

compatible: "adi,no-os-max22017_gpio"


properties:
```

## binding_parser/dts/bindings/no-os-max22017_iio_desc.yaml
```yaml
# Copyright (c) 2025 Analog Devices Inc.

description: No-os binding for max22017_iio_desc device

compatible: "adi,no-os-max22017_iio_desc"


properties:
```

## binding_parser/dts/bindings/no-os-max22190.yaml
```yaml
# Copyright (c) 2025 Analog Devices Inc.

description: No-os binding for max22190 device

compatible: "adi,no-os-max22190"

include: [spi-device.yaml, gpio-controller.yaml]

properties:
  crc_en:
    type: bool
```

## binding_parser/dts/bindings/no-os-max22190_iio_desc.yaml
```yaml
# Copyright (c) 2025 Analog Devices Inc.

description: No-os binding for max22190_iio_desc device

compatible: "adi,no-os-max22190_iio_desc"


properties:
```

## binding_parser/dts/bindings/no-os-max22196.yaml
```yaml
# Copyright (c) 2025 Analog Devices Inc.

description: No-os binding for max22196 device

compatible: "adi,no-os-max22196"

include: [spi-device.yaml, gpio-controller.yaml]

properties:
  chip_address:
    type: uint32_t
  crc_en:
    type: bool
  chip_id:
    type: int
    enum:
      - ID_MAX22194
      - ID_MAX22196
```

## binding_parser/dts/bindings/no-os-max22196_iio_desc.yaml
```yaml
# Copyright (c) 2025 Analog Devices Inc.

description: No-os binding for max22196_iio_desc device

compatible: "adi,no-os-max22196_iio_desc"


properties:
```

## binding_parser/dts/bindings/no-os-max22200.yaml
```yaml
# Copyright (c) 2025 Analog Devices Inc.

description: No-os binding for max22200 device

compatible: "adi,no-os-max22200"

include: [spi-device.yaml, gpio-controller.yaml]

properties:
  ch_config[MAX22200_CHANNELS_CONFIG]:
    type: int
    enum:
      - MAX22200_INDEPENDENT_MODE
      - MAX22200_PARALLEL_MODE
      - MAX22200_HALF_BRIDGE_MODE
```

## binding_parser/dts/bindings/no-os-max22200_iio_desc.yaml
```yaml
# Copyright (c) 2025 Analog Devices Inc.

description: No-os binding for max22200_iio_desc device

compatible: "adi,no-os-max22200_iio_desc"


properties:
  ch_enable[MAX22200_CHANNELS]:
    type: bool
```

## binding_parser/dts/bindings/no-os-max22516.yaml
```yaml
# Copyright (c) 2025 Analog Devices Inc.

description: No-os binding for max22516 device

compatible: "adi,no-os-max22516"

include: [spi-device.yaml]

properties:
```

## binding_parser/dts/bindings/no-os-max24287.yaml
```yaml
# Copyright (c) 2025 Analog Devices Inc.

description: No-os binding for max24287 device

compatible: "adi,no-os-max24287"

include: [gpio-controller.yaml]

properties:
  parallel:
    type: int
    enum:
      - MAX24287_TBI
      - MAX24287_RTBI
      - MAX24287_GMII
      - MAX24287_RGMII
      - MAX24287_MII
  parspeed:
    type: int
    enum:
      - MAX24287_10_HALFDUPLEX
      - MAX24287_10_FULLDUPLEX
      - MAX24287_100_HALFDUPLEX
      - MAX24287_100_FULLDUPLEX
      - MAX24287_1000_HALFDUPLEX
      - MAX24287_1000_FULLDUPLEX
      - MAX24287_1250_HALFDUPLEX
      - MAX24287_1250_FULLDUPLEX
  serial:
    type: int
    enum:
      - MAX24287_SGMII
      - MAX24287_1000BASEX
  serspeed:
    type: int
    enum:
      - MAX24287_10_HALFDUPLEX
      - MAX24287_10_FULLDUPLEX
      - MAX24287_100_HALFDUPLEX
      - MAX24287_100_FULLDUPLEX
      - MAX24287_1000_HALFDUPLEX
      - MAX24287_1000_FULLDUPLEX
      - MAX24287_1250_HALFDUPLEX
      - MAX24287_1250_FULLDUPLEX
```

## binding_parser/dts/bindings/no-os-max24287_iio.yaml
```yaml
# Copyright (c) 2025 Analog Devices Inc.

description: No-os binding for max24287_iio device

compatible: "adi,no-os-max24287_iio"


properties:
```
