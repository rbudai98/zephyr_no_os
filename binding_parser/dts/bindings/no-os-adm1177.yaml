## binding_parser/dts/bindings/no-os-adm1177.yaml
```yaml
# Copyright (c) 2025 Analog Devices Inc.

description: No-os binding for adm1177 device

compatible: "adi,no-os-adm1177"

include: [i2c-device.yaml]

properties:
```

## binding_parser/dts/bindings/no-os-adm1177_iio.yaml
```yaml
# Copyright (c) 2025 Analog Devices Inc.

description: No-os binding for adm1177_iio device

compatible: "adi,no-os-adm1177_iio"


properties:
```

## binding_parser/dts/bindings/no-os-admfm2000.yaml
```yaml
# Copyright (c) 2025 Analog Devices Inc.

description: No-os binding for admfm2000 device

compatible: "adi,no-os-admfm2000"

include: [gpio-controller.yaml]

properties:
  mixer_mode:
    type: uint8_t
  dsa_gain:
    type: int32_t
```

## binding_parser/dts/bindings/no-os-admfm2000_iio_dev.yaml
```yaml
# Copyright (c) 2025 Analog Devices Inc.

description: No-os binding for admfm2000_iio_dev device

compatible: "adi,no-os-admfm2000_iio_dev"


properties:
```

## binding_parser/dts/bindings/no-os-admv1013.yaml
```yaml
# Copyright (c) 2025 Analog Devices Inc.

description: No-os binding for admv1013 device

compatible: "adi,no-os-admv1013"

include: [spi-device.yaml]

properties:
  lo_in:
    type: unsigned long long
  input_mode:
    type: int
    enum:
      - ADMV1013_IQ_MODE
      - ADMV1013_IF_MODE
  quad_se_mode:
    type: int
    enum:
      - ADMV1013_SE_MODE_POS 
      - ADMV1013_SE_MODE_NEG 
      - ADMV1013_SE_MODE_DIFF 
  det_en:
    type: bool
  vcm_uv:
    type: unsigned int
```

## binding_parser/dts/bindings/no-os-admv1014.yaml
```yaml
# Copyright (c) 2025 Analog Devices Inc.

description: No-os binding for admv1014 device

compatible: "adi,no-os-admv1014"

include: [spi-device.yaml]

properties:
  lo_in:
    type: unsigned long long
  input_mode:
    type: int
    enum:
      - ADMV1014_IQ_MODE
      - ADMV1014_IF_MODE
  quad_se_mode:
    type: int
    enum:
      - ADMV1014_SE_MODE_POS 
      - ADMV1014_SE_MODE_NEG 
      - ADMV1014_SE_MODE_DIFF 
  det_en:
    type: bool
  vcm_mv:
    type: unsigned int
  p1db_comp_en:
    type: bool
```

## binding_parser/dts/bindings/no-os-admv8818.yaml
```yaml
# Copyright (c) 2025 Analog Devices Inc.

description: No-os binding for admv8818 device

compatible: "adi,no-os-admv8818"

include: [spi-device.yaml]

properties:
  rf_in:
    type: unsigned long long
  mode:
    type: int
    enum:
      - ADMV8818_AUTO
      - ADMV8818_MANUAL
```

## binding_parser/dts/bindings/no-os-adp1050.yaml
```yaml
# Copyright (c) 2025 Analog Devices Inc.

description: No-os binding for adp1050 device

compatible: "adi,no-os-adp1050"

include: [i2c-device.yaml, gpio-controller.yaml]

properties:
  on_off_config:
    type: uint8_t
  ext_syni:
    type: bool
  device_id:
    type: int
    enum:
      - ID_ADP1050
      - ID_ADP1051
```

## binding_parser/dts/bindings/no-os-adp1050_iio_desc.yaml
```yaml
# Copyright (c) 2025 Analog Devices Inc.

description: No-os binding for adp1050_iio_desc device

compatible: "adi,no-os-adp1050_iio_desc"


properties:
  vout_scale_monitor:
    type: uint16_t
  vin_scale_monitor:
    type: uint16_t
  iin_scale_monitor:
    type: uint16_t
```

## binding_parser/dts/bindings/no-os-adp1055.yaml
```yaml
# Copyright (c) 2025 Analog Devices Inc.

description: No-os binding for adp1055 device

compatible: "adi,no-os-adp1055"

include: [i2c-device.yaml, gpio-controller.yaml]

properties:
  on_off_config:
    type: uint8_t
  ext_syni:
    type: bool
```

## binding_parser/dts/bindings/no-os-adp5055.yaml
```yaml
# Copyright (c) 2025 Analog Devices Inc.

description: No-os binding for adp5055 device

compatible: "adi,no-os-adp5055"

include: [i2c-device.yaml]

properties:
```

## binding_parser/dts/bindings/no-os-adp5055_iio_desc.yaml
```yaml
# Copyright (c) 2025 Analog Devices Inc.

description: No-os binding for adp5055_iio_desc device

compatible: "adi,no-os-adp5055_iio_desc"


properties:
```

## binding_parser/dts/bindings/no-os-adp5589.yaml
```yaml
# Copyright (c) 2025 Analog Devices Inc.

description: No-os binding for adp5589 device

compatible: "adi,no-os-adp5589"

include: [i2c-device.yaml]

properties:
```

## binding_parser/dts/bindings/no-os-adpd188.yaml
```yaml
# Copyright (c) 2025 Analog Devices Inc.

description: No-os binding for adpd188 device

compatible: "adi,no-os-adpd188"

include: [gpio-controller.yaml]

properties:
  device:
    type: int
    enum:
      - ADPD188BI
      - ADPD1080
      - ADPD1081
  phy_opt:
    type: int
    enum:
      - ADPD188_SPI
      - ADPD188_I2C
  phy_init:
    type: union adpd188_phy_init
```

## binding_parser/dts/bindings/no-os-adpd188_iio.yaml
```yaml
# Copyright (c) 2025 Analog Devices Inc.

description: No-os binding for adpd188_iio device

compatible: "adi,no-os-adpd188_iio"


properties:
```

## binding_parser/dts/bindings/no-os-adpd410x.yaml
```yaml
# Copyright (c) 2025 Analog Devices Inc.

description: No-os binding for adpd410x device

compatible: "adi,no-os-adpd410x"

include: [gpio-controller.yaml]

properties:
  dev_ops_init:
    type: union phy_comm_init_param
  dev_type:
    type: int
    enum:
      - ADPD4100
      - ADPD4101
  clk_opt:
    type: int
    enum:
      - ADPD410X_INTLFO_INTHFO
      - ADPD410X_EXTLFO_INTHFO
      - ADPD410X_INTLFO_EXTHFO
      - ADPD410X_GENLFO_EXTHFO
  ext_lfo_freq:
    type: uint32_t
```

## binding_parser/dts/bindings/no-os-adrf6780.yaml
```yaml
# Copyright (c) 2025 Analog Devices Inc.

description: No-os binding for adrf6780 device

compatible: "adi,no-os-adrf6780"

include: [spi-device.yaml]

properties:
  lo_in:
    type: unsigned long long
  vga_buff_en:
    type: bool
  lo_buff_en:
    type: bool
  if_mode_en:
    type: bool
  lo_x2_en:
    type: bool
  lo_en:
    type: bool
  uc_bias_en:
    type: bool
  lo_sideband:
    type: bool
  vdet_out_en:
    type: bool
```

## binding_parser/dts/bindings/no-os-adrv9009.yaml
```yaml
# Copyright (c) 2025 Analog Devices Inc.

description: No-os binding for adrv9009 device

compatible: "adi,no-os-adrv9009"

include: [spi-device.yaml]

properties:
  trx_lo_frequency:
    type: uint64_t
  tx_pa_protection:
    type: taliseTxPaProtectCfg_t
```

## binding_parser/dts/bindings/no-os-adrv9025.yaml
```yaml
# Copyright (c) 2025 Analog Devices Inc.

description: No-os binding for adrv9025 device

compatible: "adi,no-os-adrv9025"

include: [spi-device.yaml]

properties:
```

## binding_parser/dts/bindings/no-os-adt7420_iio.yaml
```yaml
# Copyright (c) 2025 Analog Devices Inc.

description: No-os binding for adt7420_iio device

compatible: "adi,no-os-adt7420_iio"


properties:
```

## binding_parser/dts/bindings/no-os-adt75.yaml
```yaml
# Copyright (c) 2025 Analog Devices Inc.

description: No-os binding for adt75 device

compatible: "adi,no-os-adt75"

include: [i2c-device.yaml]

properties:
```

## binding_parser/dts/bindings/no-os-adt75_iio.yaml
```yaml
# Copyright (c) 2025 Analog Devices Inc.

description: No-os binding for adt75_iio device

compatible: "adi,no-os-adt75_iio"


properties:
```

## binding_parser/dts/bindings/no-os-adxl313.yaml
```yaml
# Copyright (c) 2025 Analog Devices Inc.

description: No-os binding for adxl313 device

compatible: "adi,no-os-adxl313"


properties:
  comm_init:
    type: union adxl313_comm_init_param
  comm_type:
    type: int
    enum:
      - ADXL313_SPI_COMM 
      - ADXL313_I2C_COMM 
  dev_type:
    type: int
    enum:
      - ID_ADXL312 
      - ID_ADXL313 
      - ID_ADXL314 
```

## binding_parser/dts/bindings/no-os-adxl313_iio_dev.yaml
```yaml
# Copyright (c) 2025 Analog Devices Inc.

description: No-os binding for adxl313_iio_dev device

compatible: "adi,no-os-adxl313_iio_dev"


properties:
```

## binding_parser/dts/bindings/no-os-adxl345.yaml
```yaml
# Copyright (c) 2025 Analog Devices Inc.

description: No-os binding for adxl345 device

compatible: "adi,no-os-adxl345"

include: [spi-device.yaml, i2c-device.yaml]

properties:
  dev_type:
    type: int
    enum:
      - ID_ADXL345
      - ID_ADXL346
  communication_type:
    type: uint8_t
  selected_range:
    type: uint8_t
  full_resolution_set:
    type: uint8_t
```
