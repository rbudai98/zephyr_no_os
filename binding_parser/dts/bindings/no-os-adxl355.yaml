## binding_parser/dts/bindings/no-os-adxl355.yaml
```yaml
# Copyright (c) 2025 Analog Devices Inc.

description: No-os binding for adxl355 device

compatible: "adi,no-os-adxl355"


properties:
  comm_init:
    type: union adxl355_comm_init_param
  comm_type:
    type: int
    enum:
      - ADXL355_SPI_COMM
      - ADXL355_I2C_COMM
  dev_type:
    type: int
    enum:
      - ID_ADXL355
      - ID_ADXL357
      - ID_ADXL359
```

## binding_parser/dts/bindings/no-os-adxl355_iio_dev.yaml
```yaml
# Copyright (c) 2025 Analog Devices Inc.

description: No-os binding for adxl355_iio_dev device

compatible: "adi,no-os-adxl355_iio_dev"


properties:
```

## binding_parser/dts/bindings/no-os-adxl362.yaml
```yaml
# Copyright (c) 2025 Analog Devices Inc.

description: No-os binding for adxl362 device

compatible: "adi,no-os-adxl362"

include: [spi-device.yaml]

properties:
```

## binding_parser/dts/bindings/no-os-adxl367.yaml
```yaml
# Copyright (c) 2025 Analog Devices Inc.

description: No-os binding for adxl367 device

compatible: "adi,no-os-adxl367"

include: [spi-device.yaml, i2c-device.yaml]

properties:
  comm_type:
    type: int
    enum:
      - ADXL367_SPI_COMM
      - ADXL367_I2C_COMM
  i2c_slave_address:
    type: uint8_t
```

## binding_parser/dts/bindings/no-os-adxl367_iio.yaml
```yaml
# Copyright (c) 2025 Analog Devices Inc.

description: No-os binding for adxl367_iio device

compatible: "adi,no-os-adxl367_iio"


properties:
```

## binding_parser/dts/bindings/no-os-adxl372.yaml
```yaml
# Copyright (c) 2025 Analog Devices Inc.

description: No-os binding for adxl372 device

compatible: "adi,no-os-adxl372"

include: [spi-device.yaml, i2c-device.yaml, gpio-controller.yaml]

properties:
  bw:
    type: int
    enum:
      - ADXL372_BW_200HZ
      - ADXL372_BW_400HZ
      - ADXL372_BW_800HZ
      - ADXL372_BW_1600HZ
      - ADXL372_BW_3200HZ
  odr:
    type: int
    enum:
      - ADXL372_ODR_400HZ
      - ADXL372_ODR_800HZ
      - ADXL372_ODR_1600HZ
      - ADXL372_ODR_3200HZ
      - ADXL372_ODR_6400HZ
  wur:
    type: int
    enum:
      - ADXL372_WUR_52ms
      - ADXL372_WUR_104ms
      - ADXL372_WUR_208ms
      - ADXL372_WUR_512ms
      - ADXL372_WUR_2048ms
      - ADXL372_WUR_4096ms
      - ADXL372_WUR_8192ms
      - ADXL372_WUR_24576ms
  act_proc_mode:
    type: int
    enum:
      - ADXL372_DEFAULT
      - ADXL372_LINKED
      - ADXL372_LOOPED
  th_mode:
    type: int
    enum:
      - ADXL372_INSTANT_ON_LOW_TH
      - ADXL372_INSTANT_ON_HIGH_TH
  activity_time:
    type: uint8_t
  inactivity_time:
    type: uint16_t
  filter_settle:
    type: int
    enum:
      - ADXL372_FILTER_SETTLE_370
      - ADXL372_FILTER_SETTLE_16
  op_mode:
    type: int
    enum:
      - ADXL372_STANDBY
      - ADXL372_WAKE_UP
      - ADXL372_INSTANT_ON
      - ADXL372_FULL_BW_MEASUREMENT
  comm_type:
    type: int
    enum:
      - SPI
      - I2C
```

## binding_parser/dts/bindings/no-os-adxl38x.yaml
```yaml
# Copyright (c) 2025 Analog Devices Inc.

description: No-os binding for adxl38x device

compatible: "adi,no-os-adxl38x"


properties:
  comm_init:
    type: union adxl38x_comm_init_param
  comm_type:
    type: int
    enum:
      - ADXL38X_SPI_COMM
      - ADXL38X_I2C_COMM
  dev_type:
    type: int
    enum:
      - ID_ADXL380
      - ID_ADXL382
```

## binding_parser/dts/bindings/no-os-adxrs290.yaml
```yaml
# Copyright (c) 2025 Analog Devices Inc.

description: No-os binding for adxrs290 device

compatible: "adi,no-os-adxrs290"

include: [spi-device.yaml, gpio-controller.yaml]

properties:
  mode:
    type: int
    enum:
      - ADXRS290_MODE_STANDBY
      - ADXRS290_MODE_MEASUREMENT
  lpf:
    type: int
    enum:
      - ADXRS290_LPF_480HZ
      - ADXRS290_LPF_320HZ
      - ADXRS290_LPF_160HZ
      - ADXRS290_LPF_80HZ
      - ADXRS290_LPF_56HZ6
      - ADXRS290_LPF_40HZ
      - ADXRS290_LPF_28HZ3
      - ADXRS290_LPF_20HZ
  hpf:
    type: int
    enum:
      - ADXRS290_HPF_ALL_PASS
      - ADXRS290_HPF_0HZ011
      - ADXRS290_HPF_0HZ022
      - ADXRS290_HPF_0HZ044
      - ADXRS290_HPF_0HZ087
      - ADXRS290_HPF_0HZ175
      - ADXRS290_HPF_0HZ350
      - ADXRS290_HPF_0HZ700
      - ADXRS290_HPF_1HZ400
      - ADXRS290_HPF_2HZ800
      - ADXRS290_HPF_11HZ30
```

## binding_parser/dts/bindings/no-os-adxrs453.yaml
```yaml
# Copyright (c) 2025 Analog Devices Inc.

description: No-os binding for adxrs453 device

compatible: "adi,no-os-adxrs453"

include: [spi-device.yaml]

properties:
```

## binding_parser/dts/bindings/no-os-axi_pwm.yaml
```yaml
# Copyright (c) 2025 Analog Devices Inc.

description: No-os binding for axi_pwm device

compatible: "adi,no-os-axi_pwm"


properties:
  base_addr:
    type: uint32_t
  ref_clock_Hz:
    type: uint32_t
  channel:
    type: uint32_t
```

## binding_parser/dts/bindings/no-os-axi_sysid.yaml
```yaml
# Copyright (c) 2025 Analog Devices Inc.

description: No-os binding for axi_sysid device

compatible: "adi,no-os-axi_sysid"


properties:
  base:
    type: uint32_t
```

## binding_parser/dts/bindings/no-os-dac_demo.yaml
```yaml
# Copyright (c) 2025 Analog Devices Inc.

description: No-os binding for dac_demo device

compatible: "adi,no-os-dac_demo"


properties:
  dev_global_attr:
    type: uint32_t
  dev_ch_attr[MAX_DAC_ADDR]:
    type: uint32_t
  loopback_buffer_len:
    type: uint32_t
```

## binding_parser/dts/bindings/no-os-display.yaml
```yaml
# Copyright (c) 2025 Analog Devices Inc.

description: No-os binding for display device

compatible: "adi,no-os-display"


properties:
  cols_nb:
    type: uint8_t
  rows_nb:
    type: uint8_t
```

## binding_parser/dts/bindings/no-os-eeprom_24xx32a.yaml
```yaml
# Copyright (c) 2025 Analog Devices Inc.

description: No-os binding for eeprom_24xx32a device

compatible: "adi,no-os-eeprom_24xx32a"

include: [i2c-device.yaml]

properties:
```

## binding_parser/dts/bindings/no-os-hmc630x.yaml
```yaml
# Copyright (c) 2025 Analog Devices Inc.

description: No-os binding for hmc630x device

compatible: "adi,no-os-hmc630x"

include: [gpio-controller.yaml]

properties:
  type:
    type: int
    enum:
      - HMC6300
      - HMC6301
  ref_clk:
    type: int
    enum:
      - HMC6300_REF_CLK_71p42857MHz
      - HMC6300_REF_CLK_75MHz
      - HMC6300_REF_CLK_142p8571MHz
      - HMC6300_REF_CLK_154p2857MHz
  enabled:
    type: bool
  temp_en:
    type: bool
  vco:
    type: uint64_t
  if_attn:
    type: uint8_t
```

## binding_parser/dts/bindings/no-os-hmc630x_iio.yaml
```yaml
# Copyright (c) 2025 Analog Devices Inc.

description: No-os binding for hmc630x_iio device

compatible: "adi,no-os-hmc630x_iio"


properties:
```

## binding_parser/dts/bindings/no-os-hmc7044.yaml
```yaml
# Copyright (c) 2025 Analog Devices Inc.

description: No-os binding for hmc7044 device

compatible: "adi,no-os-hmc7044"

include: [spi-device.yaml]

properties:
  export_no_os_clk:
    type: bool
  is_hmc7043:
    type: bool
  clkin_freq[4]:
    type: uint32_t
  clkin_freq_ccf[4]:
    type: uint32_t
  vcxo_freq:
    type: uint32_t
  pll1_pfd:
    type: uint32_t
  pfd1_limit:
    type: uint32_t
  pll1_cp_current:
    type: uint32_t
  pll2_freq:
    type: uint32_t
  pll1_loop_bw:
    type: uint32_t
  sysref_timer_div:
    type: uint32_t
  pll1_ref_prio_ctrl:
    type: unsigned int
  pll1_ref_autorevert_en:
    type: bool
  clkin0_rfsync_en:
    type: bool
  clkin1_vcoin_en:
    type: bool
  high_performance_mode_clock_dist_en:
    type: bool
  rf_reseeder_disable:
    type: bool
  hmc_two_level_tree_sync_en:
    type: bool
  jesd204_sysref_provider:
    type: bool
  jesd204_max_sysref_frequency_hz:
    type: uint32_t
  jesd204_desired_sysref_frequency_hz:
    type: uint32_t
  jdev_skip_sysref_freq_calc:
    type: bool
  sync_pin_mode:
    type: unsigned int
  pulse_gen_mode:
    type: uint32_t
  in_buf_mode[5]:
    type: uint32_t
  gpi_ctrl[4]:
    type: uint32_t
  gpo_ctrl[4]:
    type: uint32_t
  num_channels:
    type: uint32_t
```

## binding_parser/dts/bindings/no-os-iio_ad713x.yaml
```yaml
# Copyright (c) 2025 Analog Devices Inc.

description: No-os binding for iio_ad713x device

compatible: "adi,no-os-iio_ad713x"


properties:
  num_channels:
    type: uint8_t
```

## binding_parser/dts/bindings/no-os-iio_ad9361.yaml
```yaml
# Copyright (c) 2025 Analog Devices Inc.

description: No-os binding for iio_ad9361 device

compatible: "adi,no-os-iio_ad9361"


properties:
```

## binding_parser/dts/bindings/no-os-iio_axi_adc.yaml
```yaml
# Copyright (c) 2025 Analog Devices Inc.

description: No-os binding for iio_axi_adc device

compatible: "adi,no-os-iio_axi_adc"


properties:
```

## binding_parser/dts/bindings/no-os-iio_axi_dac.yaml
```yaml
# Copyright (c) 2025 Analog Devices Inc.

description: No-os binding for iio_axi_dac device

compatible: "adi,no-os-iio_axi_dac"


properties:
```

## binding_parser/dts/bindings/no-os-link.yaml
```yaml
# Copyright (c) 2025 Analog Devices Inc.

description: No-os binding for link device

compatible: "adi,no-os-link"


properties:
  device_id:
    type: uint32_t
  octets_per_frame:
    type: uint32_t
  frames_per_multiframe:
    type: uint32_t
  samples_per_converter_per_frame:
    type: uint32_t
  high_density:
    type: uint32_t
  converter_resolution:
    type: uint32_t
  bits_per_sample:
    type: uint32_t
  converters_per_device:
    type: uint32_t
  control_bits_per_sample:
    type: uint32_t
  lanes_per_device:
    type: uint32_t
  subclass:
    type: uint32_t
  link_mode:
    type: uint32_t
  dual_link:
    type: uint32_t
  version:
    type: uint32_t
  logical_lane_mapping[8]:
    type: uint8_t
  link_converter_select[16]:
    type: uint8_t
  tpl_phase_adjust:
    type: uint32_t
```

## binding_parser/dts/bindings/no-os-lt3074.yaml
```yaml
# Copyright (c) 2025 Analog Devices Inc.

description: No-os binding for lt3074 device

compatible: "adi,no-os-lt3074"

include: [i2c-device.yaml, gpio-controller.yaml]

properties:
  crc_en:
    type: bool
```

## binding_parser/dts/bindings/no-os-lt3074_iio_desc.yaml
```yaml
# Copyright (c) 2025 Analog Devices Inc.

description: No-os binding for lt3074_iio_desc device

compatible: "adi,no-os-lt3074_iio_desc"


properties:
```

## binding_parser/dts/bindings/no-os-lt7170.yaml
```yaml
# Copyright (c) 2025 Analog Devices Inc.

description: No-os binding for lt7170 device

compatible: "adi,no-os-lt7170"

include: [i2c-device.yaml, gpio-controller.yaml]

properties:
  chip_id:
    type: int
    enum:
      - ID_LT7170
      - ID_LT7170_1
      - ID_LT7171
      - ID_LT7171_1
  fault_cfg:
    type: int
    enum:
      - LT7170_FAULT_PIN_INPUT
      - LT7170_FAULT_PIN_OUTPUT
  external_clk_en:
    type: bool
  crc_en:
    type: bool
```
