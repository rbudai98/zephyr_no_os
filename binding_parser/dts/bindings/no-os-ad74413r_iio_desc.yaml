## binding_parser/dts/bindings/no-os-ad74413r_iio_desc.yaml
```yaml
# Copyright (c) 2025 Analog Devices Inc.

description: No-os binding for ad74413r_iio_desc device

compatible: "adi,no-os-ad74413r_iio_desc"


properties:
```

## binding_parser/dts/bindings/no-os-ad74416h.yaml
```yaml
# Copyright (c) 2025 Analog Devices Inc.

description: No-os binding for ad74416h device

compatible: "adi,no-os-ad74416h"

include: [spi-device.yaml, gpio-controller.yaml]

properties:
  id:
    type: int
    enum:
      - ID_AD74416H
      - ID_AD74414H
  dev_addr:
    type: uint8_t
```

## binding_parser/dts/bindings/no-os-ad74xx.yaml
```yaml
# Copyright (c) 2025 Analog Devices Inc.

description: No-os binding for ad74xx device

compatible: "adi,no-os-ad74xx"

include: [spi-device.yaml, gpio-controller.yaml]

properties:
  device_bits_number:
    type: int8_t
  part_number:
    type: int
    enum:
      - ID_AD7466 
      - ID_AD7467 
      - ID_AD7468 
      - ID_AD7475 
      - ID_AD7476 
      - ID_AD7476A 
      - ID_AD7477 
      - ID_AD7477A 
      - ID_AD7478 
      - ID_AD7478A 
      - ID_AD7495 
```

## binding_parser/dts/bindings/no-os-ad7606.yaml
```yaml
# Copyright (c) 2025 Analog Devices Inc.

description: No-os binding for ad7606 device

compatible: "adi,no-os-ad7606"

include: [spi-device.yaml, gpio-controller.yaml]

properties:
  device_id:
    type: int
    enum:
      - ID_AD7605_4
      - ID_AD7606_4
      - ID_AD7606_6
      - ID_AD7606_8
      - ID_AD7606B
      - ID_AD7606C_16
      - ID_AD7606C_18
      - ID_AD7608
      - ID_AD7609
  sw_mode:
    type: bool
  parallel_interface:
    type: bool
  offset_ch[AD7606_MAX_CHANNELS]:
    type: int8_t
  phase_ch[AD7606_MAX_CHANNELS]:
    type: uint8_t
  gain_ch[AD7606_MAX_CHANNELS]:
    type: uint8_t
```

## binding_parser/dts/bindings/no-os-ad7606_axi.yaml
```yaml
# Copyright (c) 2025 Analog Devices Inc.

description: No-os binding for ad7606_axi device

compatible: "adi,no-os-ad7606_axi"


properties:
  axi_clkgen_rate:
    type: uint32_t
  core_baseaddr:
    type: uint32_t
  rx_dma_baseaddr:
    type: uint32_t
  reg_access_speed:
    type: uint32_t
```

## binding_parser/dts/bindings/no-os-ad7616.yaml
```yaml
# Copyright (c) 2025 Analog Devices Inc.

description: No-os binding for ad7616 device

compatible: "adi,no-os-ad7616"

include: [spi-device.yaml, gpio-controller.yaml]

properties:
  axi_clkgen_rate:
    type: uint32_t
  reg_access_speed:
    type: uint32_t
  crc:
    type: uint8_t
  core_baseaddr:
    type: uint32_t
  mode:
    type: int
    enum:
      - AD7616_SW
      - AD7616_HW
  va[8]:
    type: int
    enum:
      - AD7616_2V5 
      - AD7616_5V 
      - AD7616_10V 
  vb[8]:
    type: int
    enum:
      - AD7616_2V5 
      - AD7616_5V 
      - AD7616_10V 
  osr:
    type: int
    enum:
      - AD7616_OSR_0
      - AD7616_OSR_2
      - AD7616_OSR_4
      - AD7616_OSR_8
      - AD7616_OSR_16
      - AD7616_OSR_32
      - AD7616_OSR_64
      - AD7616_OSR_128
```

## binding_parser/dts/bindings/no-os-ad7689.yaml
```yaml
# Copyright (c) 2025 Analog Devices Inc.

description: No-os binding for ad7689 device

compatible: "adi,no-os-ad7689"

include: [spi-device.yaml]

properties:
  id:
    type: int
    enum:
      - ID_AD7689
      - ID_AD7682
      - ID_AD7949
      - ID_AD7699
```

## binding_parser/dts/bindings/no-os-ad7746.yaml
```yaml
# Copyright (c) 2025 Analog Devices Inc.

description: No-os binding for ad7746 device

compatible: "adi,no-os-ad7746"

include: [i2c-device.yaml]

properties:
  id:
    type: int
    enum:
      - ID_AD7745
      - ID_AD7746
      - ID_AD7747
```

## binding_parser/dts/bindings/no-os-ad7746_iio.yaml
```yaml
# Copyright (c) 2025 Analog Devices Inc.

description: No-os binding for ad7746_iio device

compatible: "adi,no-os-ad7746_iio"


properties:
```

## binding_parser/dts/bindings/no-os-ad77681.yaml
```yaml
# Copyright (c) 2025 Analog Devices Inc.

description: No-os binding for ad77681 device

compatible: "adi,no-os-ad77681"

include: [spi-device.yaml]

properties:
  power_mode:
    type: int
    enum:
      - AD77681_ECO 
      - AD77681_MEDIAN 
      - AD77681_FAST 
  mclk_div:
    type: int
    enum:
      - AD77681_MCLK_DIV_16 
      - AD77681_MCLK_DIV_8 
      - AD77681_MCLK_DIV_4 
      - AD77681_MCLK_DIV_2 
  conv_mode:
    type: int
    enum:
      - AD77681_CONV_CONTINUOUS 
      - AD77681_CONV_ONE_SHOT 
      - AD77681_CONV_SINGLE 
      - AD77681_CONV_PERIODIC 
      - AD77681_CONV_STANDBY 
  diag_mux_sel:
    type: int
    enum:
      - AD77681_TEMP_SENSOR 
      - AD77681_AIN_SHORT 
      - AD77681_POSITIVE_FS 
      - AD77681_NEGATIVE_FS 
  conv_diag_sel:
    type: bool
  conv_len:
    type: int
    enum:
      - AD77681_CONV_24BIT 
      - AD77681_CONV_16BIT 
  crc_sel:
    type: int
    enum:
      - AD77681_CRC
      - AD77681_XOR
      - AD77681_NO_CRC
  status_bit:
    type: uint8_t
  VCM_out:
    type: int
    enum:
      - AD77681_VCM_HALF_VCC 
      - AD77681_VCM_2_5V 
      - AD77681_VCM_2_05V 
      - AD77681_VCM_1_9V 
      - AD77681_VCM_1_65V 
      - AD77681_VCM_1_1V 
      - AD77681_VCM_0_9V 
      - AD77681_VCM_OFF 
  AINn:
    type: int
    enum:
      - AD77681_AINn_ENABLED 
      - AD77681_AINn_DISABLED 
  AINp:
    type: int
    enum:
      - AD77681_AINp_ENABLED 
      - AD77681_AINp_DISABLED 
  REFn:
    type: int
    enum:
      - AD77681_BUFn_ENABLED 
      - AD77681_BUFn_DISABLED 
      - AD77681_BUFn_FULL_BUFFER_ON 
  REFp:
    type: int
    enum:
      - AD77681_BUFp_ENABLED 
      - AD77681_BUFp_DISABLED 
      - AD77681_BUFp_FULL_BUFFER_ON 
  filter:
    type: int
    enum:
      - AD77681_SINC5 
      - AD77681_SINC5_DECx8 
      - AD77681_SINC5_DECx16 
      - AD77681_SINC3 
      - AD77681_FIR 
  decimate:
    type: int
    enum:
      - AD77681_SINC5_FIR_DECx32 
      - AD77681_SINC5_FIR_DECx64 
      - AD77681_SINC5_FIR_DECx128 
      - AD77681_SINC5_FIR_DECx256 
      - AD77681_SINC5_FIR_DECx512 
      - AD77681_SINC5_FIR_DECx1024 
  sinc3_osr:
    type: uint16_t
  vref:
    type: uint16_t
  mclk:
    type: uint16_t
  sample_rate:
    type: uint32_t
  data_frame_byte:
    type: uint8_t
```

## binding_parser/dts/bindings/no-os-ad7780.yaml
```yaml
# Copyright (c) 2025 Analog Devices Inc.

description: No-os binding for ad7780 device

compatible: "adi,no-os-ad7780"

include: [spi-device.yaml, gpio-controller.yaml]

properties:
```

## binding_parser/dts/bindings/no-os-ad7799.yaml
```yaml
# Copyright (c) 2025 Analog Devices Inc.

description: No-os binding for ad7799 device

compatible: "adi,no-os-ad7799"

include: [spi-device.yaml]

properties:
  chip_type:
    type: int
    enum:
      - ID_AD7798 
      - ID_AD7799 
  gain:
    type: uint8_t
  polarity:
    type: bool
  vref_mv:
    type: uint32_t
  precision:
    type: int
    enum:
      - AD7799_PRECISION_MV
      - AD7799_PRECISION_UV
```

## binding_parser/dts/bindings/no-os-ad796x.yaml
```yaml
# Copyright (c) 2025 Analog Devices Inc.

description: No-os binding for ad796x device

compatible: "adi,no-os-ad796x"

include: [gpio-controller.yaml]

properties:
  mode:
    type: int
    enum:
      - AD796X_MODE0_POWER_DOWN
      - AD796X_MODE1_EXT_REF_5P0
      - AD796X_MODE2_INT_REF_4P0
      - AD796X_MODE3_EXT_REF_4P0
      - AD796X_MODE4_SNOOZE
      - AD796X_MODE5_TEST
      - AD796X_MODE6_INVALID
      - AD796X_MODE7_EXT_REF_5P0_9MHZ
      - AD796X_MODE8_INT_REF_4P0_9MHZ
      - AD796X_MODE9_EXT_REF_4P0_9MHZ
      - AD796X_MODE10_SNOOZE2
```

## binding_parser/dts/bindings/no-os-ad7980.yaml
```yaml
# Copyright (c) 2025 Analog Devices Inc.

description: No-os binding for ad7980 device

compatible: "adi,no-os-ad7980"

include: [spi-device.yaml, gpio-controller.yaml]

properties:
```

## binding_parser/dts/bindings/no-os-ad799x.yaml
```yaml
# Copyright (c) 2025 Analog Devices Inc.

description: No-os binding for ad799x device

compatible: "adi,no-os-ad799x"

include: [i2c-device.yaml]

properties:
  part_number:
    type: int
    enum:
      - AD7991
      - AD7995
      - AD7999
```

## binding_parser/dts/bindings/no-os-ad8460.yaml
```yaml
# Copyright (c) 2025 Analog Devices Inc.

description: No-os binding for ad8460 device

compatible: "adi,no-os-ad8460"

include: [spi-device.yaml, gpio-controller.yaml]

properties:
  refio_1p2v_mv:
    type: int
  ext_resistor_ohms:
    type: uint32_t
```

## binding_parser/dts/bindings/no-os-ad8460_iio.yaml
```yaml
# Copyright (c) 2025 Analog Devices Inc.

description: No-os binding for ad8460_iio device

compatible: "adi,no-os-ad8460_iio"


properties:
```

## binding_parser/dts/bindings/no-os-ad9081.yaml
```yaml
# Copyright (c) 2025 Analog Devices Inc.

description: No-os binding for ad9081 device

compatible: "adi,no-os-ad9081"

include: [spi-device.yaml, gpio-controller.yaml]

properties:
  master_slave_sync_gpio_num:
    type: uint8_t
  sysref_coupling_ac_en:
    type: bool
  sysref_cmos_input_enable:
    type: bool
  sysref_cmos_single_end_term_pos:
    type: uint8_t
  sysref_cmos_single_end_term_neg:
    type: uint8_t
  multidevice_instance_count:
    type: uint32_t
  jesd_sync_pins_01_swap_enable:
    type: bool
  config_sync_0a_cmos_enable:
    type: bool
  lmfc_delay_dac_clk_cycles:
    type: uint32_t
  nco_sync_ms_extra_lmfc_num:
    type: uint32_t
  nco_sync_direct_sysref_mode_enable:
    type: bool
  sysref_average_cnt_exp:
    type: uint32_t
  continuous_sysref_mode_disable:
    type: bool
  tx_disable:
    type: bool
  rx_disable:
    type: bool
  dac_frequency_hz:
    type: uint64_t
  tx_main_interpolation:
    type: uint32_t
  tx_main_nco_frequency_shift_hz[MAX_NUM_MAIN_DATAPATHS]:
    type: int64_t
  tx_dac_channel_crossbar_select[MAX_NUM_MAIN_DATAPATHS]:
    type: uint8_t
  tx_maindp_dac_1x_non1x_crossbar_select[MAX_NUM_MAIN_DATAPATHS]:
    type: uint8_t
  tx_full_scale_current_ua[MAX_NUM_MAIN_DATAPATHS]:
    type: uint32_t
  tx_channel_interpolation:
    type: uint32_t
  tx_channel_nco_frequency_shift_hz[MAX_NUM_CHANNELIZER]:
    type: int64_t
  tx_channel_gain[MAX_NUM_CHANNELIZER]:
    type: uint16_t
  adc_frequency_hz:
    type: uint64_t
  nyquist_zone[MAX_NUM_MAIN_DATAPATHS]:
    type: uint32_t
  rx_main_nco_frequency_shift_hz[MAX_NUM_MAIN_DATAPATHS]:
    type: int64_t
  rx_main_decimation[MAX_NUM_MAIN_DATAPATHS]:
    type: uint32_t
  rx_main_complex_to_real_enable[MAX_NUM_MAIN_DATAPATHS]:
    type: uint8_t
  rx_main_digital_gain_6db_enable[MAX_NUM_MAIN_DATAPATHS]:
    type: uint8_t
  rx_main_enable[MAX_NUM_MAIN_DATAPATHS]:
    type: uint8_t
  rx_channel_nco_frequency_shift_hz[MAX_NUM_CHANNELIZER]:
    type: int64_t
  rx_channel_decimation[MAX_NUM_CHANNELIZER]:
    type: uint32_t
  rx_channel_complex_to_real_enable[MAX_NUM_CHANNELIZER]:
    type: uint8_t
  rx_channel_nco_mixer_mode[MAX_NUM_CHANNELIZER]:
    type: uint8_t
  rx_channel_digital_gain_6db_enable[MAX_NUM_CHANNELIZER]:
    type: uint8_t
  rx_channel_enable[MAX_NUM_CHANNELIZER]:
    type: uint8_t
  rx_cddc_nco_channel_select_mode[MAX_NUM_MAIN_DATAPATHS]:
    type: uint8_t
  rx_ffh_gpio_mux_selection[6]:
    type: uint8_t
```

## binding_parser/dts/bindings/no-os-ad9083.yaml
```yaml
# Copyright (c) 2025 Analog Devices Inc.

description: No-os binding for ad9083 device

compatible: "adi,no-os-ad9083"

include: [spi-device.yaml, gpio-controller.yaml]

properties:
  uc:
    type: uint8_t
```

## binding_parser/dts/bindings/no-os-ad9144.yaml
```yaml
# Copyright (c) 2025 Analog Devices Inc.

description: No-os binding for ad9144 device

compatible: "adi,no-os-ad9144"

include: [spi-device.yaml]

properties:
  spi3wire:
    type: uint8_t
  num_converters:
    type: uint8_t
  num_lanes:
    type: uint8_t
  interpolation:
    type: uint8_t
  fcenter_shift:
    type: unsigned int
  stpl_samples[4][4]:
    type: uint32_t
  lane_rate_kbps:
    type: uint32_t
  prbs_type:
    type: uint32_t
  jesd204_mode:
    type: uint8_t
  jesd204_subclass:
    type: uint8_t
  jesd204_scrambling:
    type: uint8_t
  lane_mux[8]:
    type: uint8_t
  pll_enable:
    type: uint8_t
  pll_ref_frequency_khz:
    type: uint32_t
  pll_dac_frequency_khz:
    type: uint32_t
```

## binding_parser/dts/bindings/no-os-ad9152.yaml
```yaml
# Copyright (c) 2025 Analog Devices Inc.

description: No-os binding for ad9152 device

compatible: "adi,no-os-ad9152"

include: [spi-device.yaml]

properties:
  stpl_samples[2][4]:
    type: uint32_t
  interpolation:
    type: uint32_t
  prbs_type:
    type: uint32_t
  lane_rate_kbps:
    type: uint32_t
```

## binding_parser/dts/bindings/no-os-ad9250.yaml
```yaml
# Copyright (c) 2025 Analog Devices Inc.

description: No-os binding for ad9250 device

compatible: "adi,no-os-ad9250"

include: [spi-device.yaml]

properties:
```

## binding_parser/dts/bindings/no-os-ad9265.yaml
```yaml
# Copyright (c) 2025 Analog Devices Inc.

description: No-os binding for ad9265 device

compatible: "adi,no-os-ad9265"

include: [spi-device.yaml]

properties:
  output_mode:
    type: uint8_t
  dco:
    type: uint8_t
  dco_en:
    type: uint8_t
  nb_lanes:
    type: uint8_t
```

## binding_parser/dts/bindings/no-os-ad9434.yaml
```yaml
# Copyright (c) 2025 Analog Devices Inc.

description: No-os binding for ad9434 device

compatible: "adi,no-os-ad9434"

include: [spi-device.yaml]

properties:
```

## binding_parser/dts/bindings/no-os-ad9467.yaml
```yaml
# Copyright (c) 2025 Analog Devices Inc.

description: No-os binding for ad9467 device

compatible: "adi,no-os-ad9467"

include: [spi-device.yaml]

properties:
```
