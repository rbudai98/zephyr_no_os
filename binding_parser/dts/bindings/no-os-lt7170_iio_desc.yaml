## binding_parser/dts/bindings/no-os-lt7170_iio_desc.yaml
```yaml
# Copyright (c) 2025 Analog Devices Inc.

description: No-os binding for lt7170_iio_desc device

compatible: "adi,no-os-lt7170_iio_desc"


properties:
```

## binding_parser/dts/bindings/no-os-lt7182s.yaml
```yaml
# Copyright (c) 2025 Analog Devices Inc.

description: No-os binding for lt7182s device

compatible: "adi,no-os-lt7182s"

include: [i2c-device.yaml, gpio-controller.yaml]

properties:
  chip_id:
    type: int
    enum:
      - ID_LT7182S
      - ID_LT7184S
  format:
    type: int
    enum:
      - LT7182S_DATA_FORMAT_LINEAR
      - LT7182S_DATA_FORMAT_IEEE754
  fault0_cfg:
    type: int
    enum:
      - LT7182S_FAULT_PIN_INPUT
      - LT7182S_FAULT_PIN_OUTPUT
  fault1_cfg:
    type: int
    enum:
      - LT7182S_FAULT_PIN_INPUT
      - LT7182S_FAULT_PIN_OUTPUT
  external_clk_en:
    type: bool
  crc_en:
    type: bool
```

## binding_parser/dts/bindings/no-os-lt7182s_iio_desc.yaml
```yaml
# Copyright (c) 2025 Analog Devices Inc.

description: No-os binding for lt7182s_iio_desc device

compatible: "adi,no-os-lt7182s_iio_desc"


properties:
```

## binding_parser/dts/bindings/no-os-lt8491.yaml
```yaml
# Copyright (c) 2025 Analog Devices Inc.

description: No-os binding for lt8491 device

compatible: "adi,no-os-lt8491"

include: [i2c-device.yaml]

properties:
  rsense1_micro_ohms:
    type: unsigned int
  rimon_out_ohms:
    type: unsigned int
  rsense2_micro_ohms:
    type: unsigned int
  rdaco_ohms:
    type: unsigned int
  rfbout1_ohms:
    type: unsigned int
  rfbout2_ohms:
    type: unsigned int
  rdaci_ohms:
    type: unsigned int
  rfbin2_ohms:
    type: unsigned int
  rfbin1_ohms:
    type: unsigned int
```

## binding_parser/dts/bindings/no-os-lt8491_iio.yaml
```yaml
# Copyright (c) 2025 Analog Devices Inc.

description: No-os binding for lt8491_iio device

compatible: "adi,no-os-lt8491_iio"


properties:
```

## binding_parser/dts/bindings/no-os-lt8722.yaml
```yaml
# Copyright (c) 2025 Analog Devices Inc.

description: No-os binding for lt8722 device

compatible: "adi,no-os-lt8722"

include: [spi-device.yaml, gpio-controller.yaml]

properties:
  start_up_sequence:
    type: bool
```

## binding_parser/dts/bindings/no-os-lt8722_iio_dev.yaml
```yaml
# Copyright (c) 2025 Analog Devices Inc.

description: No-os binding for lt8722_iio_dev device

compatible: "adi,no-os-lt8722_iio_dev"


properties:
```

## binding_parser/dts/bindings/no-os-ltc2312.yaml
```yaml
# Copyright (c) 2025 Analog Devices Inc.

description: No-os binding for ltc2312 device

compatible: "adi,no-os-ltc2312"

include: [spi-device.yaml]

properties:
  type:
    type: int
    enum:
      - LTC2312_12
      - LTC2312_14
```

## binding_parser/dts/bindings/no-os-ltc2358.yaml
```yaml
# Copyright (c) 2025 Analog Devices Inc.

description: No-os binding for ltc2358 device

compatible: "adi,no-os-ltc2358"

include: [spi-device.yaml]

properties:
```

## binding_parser/dts/bindings/no-os-ltc2672.yaml
```yaml
# Copyright (c) 2025 Analog Devices Inc.

description: No-os binding for ltc2672 device

compatible: "adi,no-os-ltc2672"

include: [spi-device.yaml]

properties:
  id:
    type: int
    enum:
      - LTC2672_12
      - LTC2672_16
```

## binding_parser/dts/bindings/no-os-ltc268x.yaml
```yaml
# Copyright (c) 2025 Analog Devices Inc.

description: No-os binding for ltc268x device

compatible: "adi,no-os-ltc268x"

include: [spi-device.yaml]

properties:
  dev_id:
    type: int
    enum:
      - LTC2686 
      - LTC2688 
  pwd_dac_setting:
    type: uint16_t
  dither_toggle_en:
    type: uint16_t
  dither_mode[16]:
    type: bool
  crt_range[16]:
    type: int
    enum:
      - LTC268X_VOLTAGE_RANGE_0V_5V
      - LTC268X_VOLTAGE_RANGE_0V_10V
      - LTC268X_VOLTAGE_RANGE_M5V_5V
      - LTC268X_VOLTAGE_RANGE_M10V_10V
      - LTC268X_VOLTAGE_RANGE_M15V_15V
  dither_phase[16]:
    type: int
    enum:
      - LTC268X_DITH_PHASE_0
      - LTC268X_DITH_PHASE_90
      - LTC268X_DITH_PHASE_180
      - LTC268X_DITH_PHASE_270
  dither_period[16]:
    type: int
    enum:
      - LTC268X_DITH_PERIOD_4
      - LTC268X_DITH_PERIOD_8
      - LTC268X_DITH_PERIOD_16
      - LTC268X_DITH_PERIOD_32
      - LTC268X_DITH_PERIOD_64
  clk_input[16]:
    type: int
    enum:
      - LTC268X_SOFT_TGL
      - LTC268X_TGP0
      - LTC268X_TGP1
      - LTC268X_TGP2
  reg_select[16]:
    type: int
    enum:
      - LTC268X_SELECT_A_REG
      - LTC268X_SELECT_B_REG
```

## binding_parser/dts/bindings/no-os-ltc2983.yaml
```yaml
# Copyright (c) 2025 Analog Devices Inc.

description: No-os binding for ltc2983 device

compatible: "adi,no-os-ltc2983"

include: [spi-device.yaml, gpio-controller.yaml]

properties:
  mux_delay_config_us:
    type: uint32_t
  filter_notch_freq:
    type: int
    enum:
      - LTC2983_50_60HZ_REJECTION
      - LTC2983_60HZ_REJECTION
      - LTC2983_50HZ_REJECTION
  custom_addr_ptr:
    type: uint16_t
  dev_type:
    type: int
    enum:
      - ID_LTC2983
      - ID_LTC2984
      - ID_LTC2986
```

## binding_parser/dts/bindings/no-os-ltc2983_iio_desc.yaml
```yaml
# Copyright (c) 2025 Analog Devices Inc.

description: No-os binding for ltc2983_iio_desc device

compatible: "adi,no-os-ltc2983_iio_desc"


properties:
```

## binding_parser/dts/bindings/no-os-ltc2992.yaml
```yaml
# Copyright (c) 2025 Analog Devices Inc.

description: No-os binding for ltc2992 device

compatible: "adi,no-os-ltc2992"

include: [i2c-device.yaml, gpio-controller.yaml]

properties:
  resolution:
    type: int
    enum:
      - LTC2992_RESOLUTION_12_BIT
      - LTC2992_RESOLUTION_8_BIT
  calibration:
    type: int
    enum:
      - LTC2992_CALIBRATE_ALWAYS
      - LTC2992_CALIBRATE_ON_DEMAND
  measure_mode:
    type: int
    enum:
      - LTC2992_MODE_CONTINUOUS
      - LTC2992_MODE_SNAPSHOT
      - LTC2992_MODE_SINGLE_CYCLE
      - LTC2992_MODE_SHUTDOWN
  continuous_vsel:
    type: int
    enum:
      - LTC2992_CONT_VSEL_ALL
      - LTC2992_CONT_VSEL_SENSE_ONLY
      - LTC2992_CONT_VSEL_GPIO1_GPIO2
      - LTC2992_CONT_VSEL_GPIOS_ONLY
  snapshot_vsel:
    type: int
    enum:
      - LTC2992_SNAP_VSEL_SENSE1
      - LTC2992_SNAP_VSEL_SENSE2
      - LTC2992_SNAP_VSEL_GPIO1
      - LTC2992_SNAP_VSEL_GPIO2
      - LTC2992_SNAP_VSEL_GPIO3
      - LTC2992_SNAP_VSEL_GPIO4
      - LTC2992_SNAP_VSEL_SENSE1_SENSE2
      - LTC2992_SNAP_VSEL_GPIO1_GPIO2
  shunt_resistor:
    type: uint32_t
  alert_clear:
    type: bool
  fault_clear_on_read:
    type: bool
  stuck_bus_timer_wakeup_en:
    type: bool
```

## binding_parser/dts/bindings/no-os-ltc3337.yaml
```yaml
# Copyright (c) 2025 Analog Devices Inc.

description: No-os binding for ltc3337 device

compatible: "adi,no-os-ltc3337"

include: [i2c-device.yaml]

properties:
  prescale:
    type: uint8_t
```

## binding_parser/dts/bindings/no-os-ltc3350.yaml
```yaml
# Copyright (c) 2025 Analog Devices Inc.

description: No-os binding for ltc3350 device

compatible: "adi,no-os-ltc3350"

include: [i2c-device.yaml]

properties:
```

## binding_parser/dts/bindings/no-os-ltc4162l.yaml
```yaml
# Copyright (c) 2025 Analog Devices Inc.

description: No-os binding for ltc4162l device

compatible: "adi,no-os-ltc4162l"

include: [i2c-device.yaml]

properties:
  rsnsb:
    type: uint32_t
  rsnsi:
    type: uint32_t
  id:
    type: int
    enum:
      - ID_LTC4162L
      - ID_LTC4162F
      - ID_LTC4162S
      - ID_LTC4015
```

## binding_parser/dts/bindings/no-os-ltc4162l_iio.yaml
```yaml
# Copyright (c) 2025 Analog Devices Inc.

description: No-os binding for ltc4162l_iio device

compatible: "adi,no-os-ltc4162l_iio"


properties:
```

## binding_parser/dts/bindings/no-os-ltc4296.yaml
```yaml
# Copyright (c) 2025 Analog Devices Inc.

description: No-os binding for ltc4296 device

compatible: "adi,no-os-ltc4296"

include: [spi-device.yaml]

properties:
```

## binding_parser/dts/bindings/no-os-ltc4306.yaml
```yaml
# Copyright (c) 2025 Analog Devices Inc.

description: No-os binding for ltc4306 device

compatible: "adi,no-os-ltc4306"

include: [i2c-device.yaml]

properties:
```

## binding_parser/dts/bindings/no-os-ltc6953.yaml
```yaml
# Copyright (c) 2025 Analog Devices Inc.

description: No-os binding for ltc6953 device

compatible: "adi,no-os-ltc6953"

include: [spi-device.yaml]

properties:
  vco_frequency:
    type: float
```

## binding_parser/dts/bindings/no-os-ltc7841.yaml
```yaml
# Copyright (c) 2025 Analog Devices Inc.

description: No-os binding for ltc7841 device

compatible: "adi,no-os-ltc7841"

include: [i2c-device.yaml]

properties:
```

## binding_parser/dts/bindings/no-os-ltc7841_iio_desc.yaml
```yaml
# Copyright (c) 2025 Analog Devices Inc.

description: No-os binding for ltc7841_iio_desc device

compatible: "adi,no-os-ltc7841_iio_desc"


properties:
  LTC7841_rsense_value:
    type: uint8_t
```

## binding_parser/dts/bindings/no-os-ltc7871.yaml
```yaml
# Copyright (c) 2025 Analog Devices Inc.

description: No-os binding for ltc7871 device

compatible: "adi,no-os-ltc7871"

include: [spi-device.yaml, gpio-controller.yaml]

properties:
```

## binding_parser/dts/bindings/no-os-ltc7871_iio_dev.yaml
```yaml
# Copyright (c) 2025 Analog Devices Inc.

description: No-os binding for ltc7871_iio_dev device

compatible: "adi,no-os-ltc7871_iio_dev"


properties:
```
