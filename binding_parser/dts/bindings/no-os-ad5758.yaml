## binding_parser/dts/bindings/no-os-ad5758.yaml
```yaml
# Copyright (c) 2025 Analog Devices Inc.

description: No-os binding for ad5758 device

compatible: "adi,no-os-ad5758"

include: [spi-device.yaml, gpio-controller.yaml]

properties:
  crc_en:
    type: uint8_t
  dc_dc_mode:
    type: int
    enum:
      - DC_DC_POWER_OFF
      - DPC_CURRENT_MODE
      - DPC_VOLTAGE_MODE
      - PPC_CURRENT_MODE
  clkout_config:
    type: int
    enum:
      - CLKOUT_DISABLE
      - CLKOUT_ENABLE
  clkout_freq:
    type: int
    enum:
      - CLKOUT_FREQ_416_KHZ
      - CLKOUT_FREQ_435_KHZ
      - CLKOUT_FREQ_454_KHZ
      - CLKOUT_FREQ_476_KHZ
      - CLKOUT_FREQ_500_KHZ
      - CLKOUT_FREQ_526_KHZ
      - CLKOUT_FREQ_555_KHZ
      - CLKOUT_FREQ_588_KHZ
  dc_dc_ilimit:
    type: int
    enum:
      - ILIMIT_150_mA
      - ILIMIT_200_mA
      - ILIMIT_250_mA
      - ILIMIT_300_mA
      - ILIMIT_350_mA
      - ILIMIT_400_mA
  output_range:
    type: int
    enum:
      - RANGE_0V_5V 
      - RANGE_0V_10V 
      - RANGE_M5V_5V 
      - RANGE_M10V_10V 
      - RANGE_0mA_20mA 
      - RANGE_0mA_24mA 
      - RANGE_4mA_24mA 
      - RANGE_M20mA_20mA 
      - RANGE_M24mA_24mA 
      - RANGE_M1mA_22mA 
  slew_rate_clk:
    type: int
    enum:
      - SR_CLOCK_240_KHZ
      - SR_CLOCK_200_KHZ
      - SR_CLOCK_150_KHZ
      - SR_CLOCK_128_KHZ
      - SR_CLOCK_64_KHZ
      - SR_CLOCK_32_KHZ
      - SR_CLOCK_16_KHZ
      - SR_CLOCK_8_KHZ
      - SR_CLOCK_4_KHZ
      - SR_CLOCK_2_KHZ
      - SR_CLOCK_1_KHZ
      - SR_CLOCK_512_HZ
      - SR_CLOCK_256_HZ
      - SR_CLOCK_128_HZ
      - SR_CLOCK_64_HZ
      - SR_CLOCK_16_HZ
```

## binding_parser/dts/bindings/no-os-ad5761r.yaml
```yaml
# Copyright (c) 2025 Analog Devices Inc.

description: No-os binding for ad5761r device

compatible: "adi,no-os-ad5761r"

include: [spi-device.yaml, gpio-controller.yaml]

properties:
  gpio_reset_value:
    type: uint8_t
  gpio_clr_value:
    type: uint8_t
  gpio_ldac_value:
    type: uint8_t
  type:
    type: int
    enum:
      - AD5761R
      - AD5721R
  out_range:
    type: int
    enum:
      - AD5761R_RANGE_M_10V_TO_P_10V
      - AD5761R_RANGE_0_V_TO_P_10V
      - AD5761R_RANGE_M_5V_TO_P_5V
      - AD5761R_RANGE_0V_TO_P_5V
      - AD5761R_RANGE_M_2V5_TO_P_7V5
      - AD5761R_RANGE_M_3V_TO_P_3V
      - AD5761R_RANGE_0V_TO_P_16V
      - AD5761R_RANGE_0V_TO_P_20V
  pwr_voltage:
    type: int
    enum:
      - AD5761R_SCALE_ZERO
      - AD5761R_SCALE_HALF
      - AD5761R_SCALE_FULL
  clr_voltage:
    type: int
    enum:
      - AD5761R_SCALE_ZERO
      - AD5761R_SCALE_HALF
      - AD5761R_SCALE_FULL
  int_ref_en:
    type: bool
  exc_temp_sd_en:
    type: bool
  b2c_range_en:
    type: bool
  ovr_en:
    type: bool
  daisy_chain_en:
    type: bool
```

## binding_parser/dts/bindings/no-os-ad5766.yaml
```yaml
# Copyright (c) 2025 Analog Devices Inc.

description: No-os binding for ad5766 device

compatible: "adi,no-os-ad5766"

include: [spi-device.yaml, gpio-controller.yaml]

properties:
  daisy_chain_en:
    type: int
    enum:
      - AD5766_ENABLE
      - AD5766_DISABLE
  clr:
    type: int
    enum:
      - AD5766_ZERO
      - AD5766_MID
      - AD5766_FULL
  span:
    type: int
    enum:
      - AD5766_M_20V_TO_0V
      - AD5766_M_16V_TO_0V
      - AD5766_M_10V_TO_0V
      - AD5766_M_12V_TO_P_14V
      - AD5766_M_16V_TO_P_10V
      - AD5766_M_5V_TO_P_6V
      - AD5766_M_10V_TO_P_10V
  pwr_dac_setting:
    type: uint16_t
  pwr_dither_setting:
    type: uint16_t
  dither_signal_setting:
    type: uint32_t
  inv_dither_setting:
    type: uint16_t
  dither_scale_setting:
    type: uint32_t
```

## binding_parser/dts/bindings/no-os-ad5770r.yaml
```yaml
# Copyright (c) 2025 Analog Devices Inc.

description: No-os binding for ad5770r device

compatible: "adi,no-os-ad5770r"

include: [spi-device.yaml, gpio-controller.yaml]

properties:
  external_reference:
    type: bool
  reference_selector:
    type: int
    enum:
      - AD5770R_EXT_REF_2_5_V 
      - AD5770R_INT_REF_1_25_V_OUT_ON
      - AD5770R_EXT_REF_1_25_V
      - AD5770R_INT_REF_1_25_V_OUT_OFF
  output_filter[6]:
    type: int
    enum:
      - AD5770R_OUTPUT_FILTER_RESISTOR_60_OHM 
      - AD5770R_OUTPUT_FILTER_RESISTOR_5_6_KOHM 
      - AD5770R_OUTPUT_FILTER_RESISTOR_11_2_KOHM
      - AD5770R_OUTPUT_FILTER_RESISTOR_22_2_KOHM
      - AD5770R_OUTPUT_FILTER_RESISTOR_44_4_KOHM
      - AD5770R_OUTPUT_FILTER_RESISTOR_104_KOHM
  dac_value[6]:
    type: uint16_t
  input_value[6]:
    type: uint16_t
```

## binding_parser/dts/bindings/no-os-ad5791.yaml
```yaml
# Copyright (c) 2025 Analog Devices Inc.

description: No-os binding for ad5791 device

compatible: "adi,no-os-ad5791"

include: [spi-device.yaml, gpio-controller.yaml]

properties:
  act_device:
    type: int
    enum:
      - ID_AD5760
      - ID_AD5780
      - ID_AD5781
      - ID_AD5790
      - ID_AD5791
  rbuf_gain2:
    type: bool
```

## binding_parser/dts/bindings/no-os-ad5791_iio.yaml
```yaml
# Copyright (c) 2025 Analog Devices Inc.

description: No-os binding for ad5791_iio device

compatible: "adi,no-os-ad5791_iio"


properties:
  vref_mv:
    type: uint32_t
  vref_neg_mv:
    type: uint32_t
```

## binding_parser/dts/bindings/no-os-ad5933.yaml
```yaml
# Copyright (c) 2025 Analog Devices Inc.

description: No-os binding for ad5933 device

compatible: "adi,no-os-ad5933"

include: [i2c-device.yaml]

properties:
  current_sys_clk:
    type: uint32_t
  current_clock_source:
    type: uint8_t
  current_gain:
    type: uint8_t
  current_range:
    type: uint8_t
```

## binding_parser/dts/bindings/no-os-ad5940.yaml
```yaml
# Copyright (c) 2025 Analog Devices Inc.

description: No-os binding for ad5940 device

compatible: "adi,no-os-ad5940"

include: [spi-device.yaml, gpio-controller.yaml]

properties:
```

## binding_parser/dts/bindings/no-os-ad5940_iio.yaml
```yaml
# Copyright (c) 2025 Analog Devices Inc.

description: No-os binding for ad5940_iio device

compatible: "adi,no-os-ad5940_iio"


properties:
```

## binding_parser/dts/bindings/no-os-ad6673.yaml
```yaml
# Copyright (c) 2025 Analog Devices Inc.

description: No-os binding for ad6673 device

compatible: "adi,no-os-ad6673"

include: [spi-device.yaml]

properties:
```

## binding_parser/dts/bindings/no-os-ad6676.yaml
```yaml
# Copyright (c) 2025 Analog Devices Inc.

description: No-os binding for ad6676 device

compatible: "adi,no-os-ad6676"

include: [spi-device.yaml]

properties:
  ref_clk:
    type: uint32_t
  f_adc_hz:
    type: uint32_t
  f_if_hz:
    type: uint32_t
  bw_hz:
    type: uint32_t
  bw_margin_low_mhz:
    type: uint8_t
  bw_margin_high_mhz:
    type: uint8_t
  bw_margin_if_mhz:
    type: int8_t
  decimation:
    type: uint8_t
  ext_l:
    type: uint8_t
  attenuation:
    type: uint8_t
  scale:
    type: uint8_t
  use_extclk:
    type: uint8_t
  spi3wire:
    type: uint8_t
  shuffle_ctrl:
    type: uint8_t
  shuffle_thresh:
    type: uint8_t
  scrambling_en:
    type: uint8_t
  lvds_syncb:
    type: uint8_t
  sysref_pd:
    type: uint8_t
  n_lanes:
    type: uint8_t
  frames_per_multiframe:
    type: uint8_t
  m:
    type: uint64_t
```

## binding_parser/dts/bindings/no-os-ad7091r.yaml
```yaml
# Copyright (c) 2025 Analog Devices Inc.

description: No-os binding for ad7091r device

compatible: "adi,no-os-ad7091r"

include: [spi-device.yaml]

properties:
```

## binding_parser/dts/bindings/no-os-ad7091r5.yaml
```yaml
# Copyright (c) 2025 Analog Devices Inc.

description: No-os binding for ad7091r5 device

compatible: "adi,no-os-ad7091r5"

include: [i2c-device.yaml, gpio-controller.yaml]

properties:
```

## binding_parser/dts/bindings/no-os-ad7091r8.yaml
```yaml
# Copyright (c) 2025 Analog Devices Inc.

description: No-os binding for ad7091r8 device

compatible: "adi,no-os-ad7091r8"

include: [spi-device.yaml, gpio-controller.yaml]

properties:
  vref_mv:
    type: int
  device_id:
    type: int
    enum:
      - AD7091R2
      - AD7091R4
      - AD7091R8
  sleep_mode:
    type: int
    enum:
      - AD7091R8_SLEEP_MODE_0
      - AD7091R8_SLEEP_MODE_1
      - AD7091R8_SLEEP_MODE_2
      - AD7091R8_SLEEP_MODE_3
```

## binding_parser/dts/bindings/no-os-ad7091r8_iio_dev.yaml
```yaml
# Copyright (c) 2025 Analog Devices Inc.

description: No-os binding for ad7091r8_iio_dev device

compatible: "adi,no-os-ad7091r8_iio_dev"


properties:
```

## binding_parser/dts/bindings/no-os-ad7124.yaml
```yaml
# Copyright (c) 2025 Analog Devices Inc.

description: No-os binding for ad7124 device

compatible: "adi,no-os-ad7124"

include: [spi-device.yaml]

properties:
  active_device:
    type: int
    enum:
      - ID_AD7124_4
      - ID_AD7124_8
  ref_en:
    type: bool
  power_mode:
    type: int
    enum:
      - AD7124_LOW_POWER
      - AD7124_MID_POWER
      - AD7124_HIGH_POWER
```

## binding_parser/dts/bindings/no-os-ad713x.yaml
```yaml
# Copyright (c) 2025 Analog Devices Inc.

description: No-os binding for ad713x device

compatible: "adi,no-os-ad713x"

include: [spi-device.yaml, gpio-controller.yaml]

properties:
  mode_master_nslave:
    type: bool
  dclkmode_free_ngated:
    type: bool
  dclkio_out_nin:
    type: bool
  pnd:
    type: bool
  dev_id:
    type: int
    enum:
      - ID_AD7132
      - ID_AD7134
      - ID_AD7136
      - ID_AD4134
  adc_data_len:
    type: int
    enum:
      - ADC_16_BIT_DATA
      - ADC_24_BIT_DATA
      - ADC_32_BIT_DATA
      - INVALID
  crc_header:
    type: int
    enum:
      - NO_CRC
      - CRC_6
      - CRC_8
  format:
    type: int
    enum:
      - SINGLE_CH_DC
      - DUAL_CH_DC
      - QUAD_CH_PO
      - CH_AVG_MODE
  clk_delay_en:
    type: bool
```

## binding_parser/dts/bindings/no-os-ad713x_iio.yaml
```yaml
# Copyright (c) 2025 Analog Devices Inc.

description: No-os binding for ad713x_iio device

compatible: "adi,no-os-ad713x_iio"


properties:
  vref_int:
    type: uint32_t
  vref_micro:
    type: uint32_t
```

## binding_parser/dts/bindings/no-os-ad7156.yaml
```yaml
# Copyright (c) 2025 Analog Devices Inc.

description: No-os binding for ad7156 device

compatible: "adi,no-os-ad7156"

include: [i2c-device.yaml]

properties:
  ad7156_channel1_range:
    type: float
  ad7156_channel2_range:
    type: float
```

## binding_parser/dts/bindings/no-os-ad719x.yaml
```yaml
# Copyright (c) 2025 Analog Devices Inc.

description: No-os binding for ad719x device

compatible: "adi,no-os-ad719x"

include: [spi-device.yaml, gpio-controller.yaml]

properties:
  current_polarity:
    type: uint8_t
  current_gain:
    type: int
    enum:
      - AD719X_ADC_GAIN_1 
      - AD719X_ADC_GAIN_8 
      - AD719X_ADC_GAIN_16 
      - AD719X_ADC_GAIN_32 
      - AD719X_ADC_GAIN_64 
      - AD719X_ADC_GAIN_128 
  operating_mode:
    type: int
    enum:
      - AD719X_MODE_CONT
      - AD719X_MODE_SINGLE
      - AD719X_MODE_IDLE
      - AD719X_MODE_PWRDN
      - AD719X_MODE_CAL_INT_ZERO
      - AD719X_MODE_CAL_INT_FULL
      - AD719X_MODE_CAL_SYS_ZERO
      - AD719X_MODE_CAL_SYS_FULL
  data_rate_code:
    type: uint16_t
  clock_source:
    type: int
    enum:
      - AD719X_EXT_CRYSTAL_MCLK1_MCLK2
      - AD719X_EXT_CRYSTAL_MCLK2
      - AD719X_INT_CLK_4_92_MHZ_TRIST
      - AD719X_INT_CLK_4_92_MHZ
  input_mode:
    type: uint8_t
  buffer:
    type: uint8_t
  bpdsw_mode:
    type: uint8_t
  chip_id:
    type: int
    enum:
      - AD7190 
      - AD7192 
      - AD7193 
      - AD7194 
      - AD7195 
```

## binding_parser/dts/bindings/no-os-ad7280a.yaml
```yaml
# Copyright (c) 2025 Analog Devices Inc.

description: No-os binding for ad7280a device

compatible: "adi,no-os-ad7280a"

include: [spi-device.yaml, gpio-controller.yaml]

properties:
```

## binding_parser/dts/bindings/no-os-ad7293.yaml
```yaml
# Copyright (c) 2025 Analog Devices Inc.

description: No-os binding for ad7293 device

compatible: "adi,no-os-ad7293"

include: [spi-device.yaml, gpio-controller.yaml]

properties:
```

## binding_parser/dts/bindings/no-os-ad7303.yaml
```yaml
# Copyright (c) 2025 Analog Devices Inc.

description: No-os binding for ad7303 device

compatible: "adi,no-os-ad7303"

include: [spi-device.yaml]

properties:
```

## binding_parser/dts/bindings/no-os-ad738x.yaml
```yaml
# Copyright (c) 2025 Analog Devices Inc.

description: No-os binding for ad738x device

compatible: "adi,no-os-ad738x"

include: [spi-device.yaml]

properties:
  conv_mode:
    type: int
    enum:
      - TWO_WIRE_MODE
      - ONE_WIRE_MODE
  ref_sel:
    type: int
    enum:
      - INT_REF
      - EXT_REF
  ref_voltage_mv:
    type: uint32_t
  flags:
    type: uint32_t
```

## binding_parser/dts/bindings/no-os-ad74413r.yaml
```yaml
# Copyright (c) 2025 Analog Devices Inc.

description: No-os binding for ad74413r device

compatible: "adi,no-os-ad74413r"

include: [spi-device.yaml, gpio-controller.yaml]

properties:
  chip_id:
    type: int
    enum:
      - AD74413R
      - AD74412R
```
