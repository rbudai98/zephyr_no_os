## binding_parser/dts/bindings/no-os-ad2s1210.yaml
```yaml
# Copyright (c) 2025 Analog Devices Inc.

description: No-os binding for ad2s1210 device

compatible: "adi,no-os-ad2s1210"

include: [spi-device.yaml, gpio-controller.yaml]

properties:
  resolution:
    type: int8_t
  clkin_hz:
    type: uint32_t
```

## binding_parser/dts/bindings/no-os-ad3530r.yaml
```yaml
# Copyright (c) 2025 Analog Devices Inc.

description: No-os binding for ad3530r device

compatible: "adi,no-os-ad3530r"

include: [spi-device.yaml, gpio-controller.yaml]

properties:
  chip_id:
    type: int
    enum:
      - AD3530R_ID
  vref_enable:
    type: int
    enum:
      - AD3530R_EXTERNAL_VREF_PIN_INPUT
      - AD3530R_INTERNAL_VREF_PIN_2P5V
  chn_op_mode[AD3530R_NUM_CH]:
    type: int
    enum:
      - AD3530R_CH_OPERATING_MODE_0
      - AD3530R_CH_OPERATING_MODE_1
      - AD3530R_CH_OPERATING_MODE_2
      - AD3530R_CH_OPERATING_MODE_3
  range:
    type: int
    enum:
      - AD3530R_CH_OUTPUT_RANGE_0_VREF
      - AD3530R_CH_OUTPUT_RANGE_0_2VREF
  hw_ldac_mask:
    type: uint16_t
  sw_ldac_mask:
    type: uint16_t
  crc_en:
    type: uint8_t
  mux_out_sel:
    type: int
    enum:
      - POWERED_DOWN
      - VOUT0
      - IOUT0_SOURCE_MODE
      - IOUT0_SINK_MODE
      - VOUT1
      - IOUT1_SOURCE_MODE
      - IOUT1_SINK_MODE
      - VOUT2
      - IOUT2_SOURCE_MODE
      - IOUT2_SINK_MODE
      - VOUT3
      - IOUT3_SOURCE_MODE
      - IOUT3_SINK_MODE
      - VOUT4
      - IOUT4_SOURCE_MODE
      - IOUT4_SINK_MODE
      - VOUT5
      - IOUT5_SOURCE_MODE
      - IOUT5_SINK_MODE
      - VOUT6
      - IOUT6_SOURCE_MODE
      - IOUT6_SINK_MODE
      - VOUT7
      - IOUT7_SOURCE_MODE
      - IOUT7_SINK_MODE
      - DIE_TEMPERATURE
      - TIED_TO_AGND_INTERNALLY
```

## binding_parser/dts/bindings/no-os-ad3552r.yaml
```yaml
# Copyright (c) 2025 Analog Devices Inc.

description: No-os binding for ad3552r device

compatible: "adi,no-os-ad3552r"

include: [spi-device.yaml, gpio-controller.yaml]

properties:
  chip_id:
    type: int
    enum:
      - AD3541R_ID
      - AD3542R_ID
      - AD3551R_ID
      - AD3552R_ID
  use_external_vref:
    type: bool
  vref_out_enable:
    type: bool
  sdo_drive_strength:
    type: uint8_t
  crc_en:
    type: bool
  is_simultaneous:
    type: bool
  single_transfer:
    type: bool
  axi_qspi_controller:
    type: bool
  axi_clkgen_rate:
    type: int
```

## binding_parser/dts/bindings/no-os-ad405x.yaml
```yaml
# Copyright (c) 2025 Analog Devices Inc.

description: No-os binding for ad405x device

compatible: "adi,no-os-ad405x"

include: [spi-device.yaml, gpio-controller.yaml]

properties:
  active_device:
    type: int
    enum:
      - ID_AD4050
      - ID_AD4052
  operation_mode:
    type: int
    enum:
      - AD405X_CONFIG_MODE_OP
      - AD405X_ADC_MODE_OP
      - AD405X_AVERAGING_MODE_OP
      - AD405X_BURST_AVERAGING_MODE_OP
      - AD405X_PERSISTENT_AUTO_MODE_OP
      - AD405X_NON_PERSISTENT_AUTO_MODE_OP
  rate:
    type: int
    enum:
      - AD405X_2_MSPS
      - AD405X_1_MSPS
      - AD405X_333_KSPS
      - AD405X_100_KSPS
      - AD405X_33_KSPS
      - AD405X_10_KSPS
      - AD405X_3_KSPS
      - AD405X_1_KSPS
      - AD405X_500_SPS
      - AD405X_333_SPS
      - AD405X_250_SPS
      - AD405X_200_SPS
      - AD405X_166_SPS
      - AD405X_140_SPS
      - AD405X_125_SPS
      - AD405X_111_SPS
  filter_length:
    type: int
    enum:
      - AD405X_LENGTH_2
      - AD405X_LENGTH_4
      - AD405X_LENGTH_8
      - AD405X_LENGTH_16
      - AD405X_LENGTH_32
      - AD405X_LENGTH_64
      - AD405X_LENGTH_128
      - AD405X_LENGTH_256
      - AD405X_LENGTH_512
      - AD405X_LENGTH_1024
      - AD405X_LENGTH_2048
      - AD405X_LENGTH_4096
```

## binding_parser/dts/bindings/no-os-ad4080.yaml
```yaml
# Copyright (c) 2025 Analog Devices Inc.

description: No-os binding for ad4080 device

compatible: "adi,no-os-ad4080"

include: [spi-device.yaml]

properties:
  spi3wire:
    type: bool
  addr_asc:
    type: int
    enum:
      - AD4080_ADDR_DECR
      - AD4080_ADDR_INCR
  single_instr:
    type: int
    enum:
      - AD4080_STREAM_MODE
      - AD4080_SINGLE_INST
  short_instr:
    type: int
    enum:
      - AD4080_15_BIT_ADDR
      - AD4080_7_BIT_ADDR
  op_mode:
    type: int
    enum:
      - AD4080_OP_NORMAL
      - AD4080_OP_STANDBY
      - AD4080_OP_LOW_POWER
  strict_reg:
    type: int
    enum:
      - AD4080_REG_NORMAL_MODE
      - AD4080_REG_STRICT_MODE
  intf_chk_en:
    type: int
    enum:
      - AD4080_DATA
      - AD4080_FIXED_PATTERN
  cnv_spi_lvds_lanes:
    type: int
    enum:
      - AD4080_ONE_LANE
      - AD4080_MULTIPLE_LANES
  conv_data_spi_lvds:
    type: int
    enum:
      - AD4080_CONV_DATA_LVDS
      - AD4080_CONV_DATA_SPI
  lvds_cnv_clk_cnt:
    type: uint8_t
  lvds_self_clk_mode:
    type: int
    enum:
      - AD4080_ECHO_CLK_MODE
      - AD4080_SELF_CLK_MODE
  cnv_clk_mode:
    type: int
    enum:
      - AD4080_CNV_CMOS_MODE
      - AD4080_CNV_LVDS_MODE
  lvds_vod:
    type: int
    enum:
      - AD4080_185mVPP 
      - AD4080_240mVPP 
      - AD4080_325mVPP 
  ana_dig_ldo_pd:
    type: int
    enum:
      - AD4080_AD_LDO_EN
      - AD4080_AD_LDO_DISABLE
  intf_ldo_pd:
    type: int
    enum:
      - AD4080_INTF_LDO_EN
      - AD4080_INTF_LDO_DISABLE
  fifo_mode:
    type: int
    enum:
      - AD4080_FIFO_DISABLE
      - AD4080_IMMEDIATE_TRIGGER
      - AD4080_EVENT_TRIGGER_LAST_WM
      - AD4080_EVENT_TRIGGER
  gpio_op_enable[NUM_AD4080_GPIO]:
    type: int
    enum:
      - AD4080_GPIO_INPUT
      - AD4080_GPIO_OUTPUT
  gpio_op_func_sel[NUM_AD4080_GPIO]:
    type: int
    enum:
      - AD4080_GPIO_ADI_NSPI_SDO_DATA
      - AD4080_GPIO_FIFO_FULL
      - AD4080_GPIO_FIFO_READ_DONE
      - AD4080_GPIO_FILTER_RESULT_READY
      - AD4080_GPIO_HT_DETECT
      - AD4080_GPIO_LT_DETECT
      - AD4080_GPIO_STATUS_ALERT
      - AD4080_GPIO_GPO_DATA
      - AD4080_GPIO_FILTER_SYNC_INPUT
      - AD4080_GPIO_EXT_EVENT_TRIGGER_FIFO
      - AD4080_GPIO_CNV_INHIBIT_INPUT
```

## binding_parser/dts/bindings/no-os-ad4110.yaml
```yaml
# Copyright (c) 2025 Analog Devices Inc.

description: No-os binding for ad4110 device

compatible: "adi,no-os-ad4110"

include: [spi-device.yaml]

properties:
  volt_ref:
    type: int
    enum:
      - AD4110_EXT_REF 
      - AD4110_INT_2_5V_REF 
      - AD4110_AVDD5_REF 
  data_stat:
    type: int
    enum:
      - AD4110_DISABLE
      - AD4110_ENABLE
  data_length:
    type: int
    enum:
      - AD4110_DATA_WL24
      - AD4110_DATA_WL16
  afe_crc_en:
    type: int
    enum:
      - AD4110_AFE_CRC_DISABLE
      - AD4110_AFE_CRC
  adc_crc_en:
    type: int
    enum:
      - AD4110_ADC_CRC_DISABLE
      - AD4110_ADC_XOR_CRC
      - AD4110_ADC_CRC_CRC
  op_mode:
    type: int
    enum:
      - AD4110_VOLTAGE_MODE
      - AD4110_CURRENT_MODE
      - AD4110_CURRENT_MODE_EXT_R_SEL
      - AD4110_THERMOCOUPLE
      - AD4110_FLD_POWER_MODE
      - AD4110_RTD_2W_MODE
      - AD4110_RTD_3W_MODE
      - AD4110_RTD_4W_MODE
  gain:
    type: int
    enum:
      - AD4110_GAIN_0_2
      - AD4110_GAIN_0_25
      - AD4110_GAIN_0_3
      - AD4110_GAIN_0_375
      - AD4110_GAIN_0_5
      - AD4110_GAIN_0_75
      - AD4110_GAIN_1
      - AD4110_GAIN_1_5
      - AD4110_GAIN_2
      - AD4110_GAIN_3
      - AD4110_GAIN_4
      - AD4110_GAIN_6
      - AD4110_GAIN_8
      - AD4110_GAIN_12
      - AD4110_GAIN_16
      - AD4110_GAIN_24
  sync:
    type: int
    enum:
      - AD4110_SYNC_DIS
      - AD4110_SYNC_EN
  afe_clk:
    type: int
    enum:
      - AD4110_AFE_INT_CLOCK 
      - AD4110_AFE_ADC_CLOCKED 
  adc_clk:
    type: int
    enum:
      - AD4110_ADC_INT_CLK
      - AD4110_ADC_INT_CLK_CLKIO
      - AD4110_ADC_EXT_CLK
  addr:
    type: uint8_t
  bipolar:
    type: bool
  analog_input_buff:
    type: int
    enum:
      - DISABLE_AIN_BUFFER
      - ENABLE_NEG_BUFFER
      - ENABLE_POS_BUFFER
      - ENABLE_FULL_BUFFER
  odr:
    type: int
    enum:
      - KSPS_125_A
      - KSPS_125_B
      - KSPS_62P5_A
      - KSPS_62P5_B
      - KSPS_31P25
      - KSPS_25
      - KSPS_15P625
      - KSPS_10P417
      - KSPS_5
      - KSPS_2P5
      - KSPS_1
      - SPS_500
      - SPS_400P6
      - SPS_200
      - SPS_100P2
      - SPS_60
      - SPS_50
      - SPS_20
      - SPS_16P7
      - SPS_10
      - SPS_5
  order:
    type: int
    enum:
      - sinc5_sinc1 
      - sinc3 
  nready_pin:
    type: uint32_t
```

## binding_parser/dts/bindings/no-os-ad413x.yaml
```yaml
# Copyright (c) 2025 Analog Devices Inc.

description: No-os binding for ad413x device

compatible: "adi,no-os-ad413x"

include: [spi-device.yaml, gpio-controller.yaml]

properties:
  chip_id:
    type: int
    enum:
      - AD4130_8 
  mclk:
    type: int
    enum:
      - AD413X_INT_76_8_KHZ_OUT_OFF
      - AD413X_INT_76_8_KHZ_OUT_ON
      - AD413X_EXT_76_8KHZ
      - AD413X_EXT_153_6_KHZ_DIV_2
  bipolar:
    type: uint8_t
  int_ref:
    type: int
    enum:
      - AD413X_INTREF_DISABLED
      - AD413X_INTREF_2_5V
      - AD413X_INTREF_1_25V
  v_bias:
    type: uint16_t
  data_stat:
    type: uint8_t
  spi_crc_en:
    type: uint8_t
```

## binding_parser/dts/bindings/no-os-ad413x_iio.yaml
```yaml
# Copyright (c) 2025 Analog Devices Inc.

description: No-os binding for ad413x_iio device

compatible: "adi,no-os-ad413x_iio"


properties:
```

## binding_parser/dts/bindings/no-os-ad4170.yaml
```yaml
# Copyright (c) 2025 Analog Devices Inc.

description: No-os binding for ad4170 device

compatible: "adi,no-os-ad4170"

include: [spi-device.yaml, gpio-controller.yaml]

properties:
  id:
    type: int
    enum:
      - ID_AD4170
      - ID_AD4171
      - ID_AD4172
      - ID_AD4190
      - ID_AD4195
  rdy_conv_timeout:
    type: uint32_t
```

## binding_parser/dts/bindings/no-os-ad463x.yaml
```yaml
# Copyright (c) 2025 Analog Devices Inc.

description: No-os binding for ad463x device

compatible: "adi,no-os-ad463x"

include: [spi-device.yaml, gpio-controller.yaml]

properties:
  axi_clkgen_rate:
    type: uint32_t
  reg_access_speed:
    type: uint32_t
  device_id:
    type: int
    enum:
      - ID_AD4630_24
      - ID_AD4630_20
      - ID_AD4630_16
      - ID_AD4631_24
      - ID_AD4631_20
      - ID_AD4631_16
      - ID_AD4632_24
      - ID_AD4632_20
      - ID_AD4632_16
      - ID_AD4030
      - ID_ADAQ4224
  reg_data_width:
    type: uint8_t
  lane_mode:
    type: uint8_t
  clock_mode:
    type: uint8_t
  data_rate:
    type: uint8_t
  vref:
    type: int32_t
  output_mode:
    type: uint8_t
  spi_dma_enable:
    type: bool
  offload_enable:
    type: bool
```

## binding_parser/dts/bindings/no-os-ad469x.yaml
```yaml
# Copyright (c) 2025 Analog Devices Inc.

description: No-os binding for ad469x device

compatible: "adi,no-os-ad469x"

include: [spi-device.yaml, gpio-controller.yaml]

properties:
  axi_clkgen_rate:
    type: uint32_t
  reg_access_speed:
    type: uint32_t
  reg_data_width:
    type: uint8_t
  capture_data_width:
    type: uint8_t
  dev_id:
    type: int
    enum:
      - ID_AD4695
      - ID_AD4696
      - ID_AD4697
      - ID_AD4698
  std_seq_pin_pairing:
    type: int
    enum:
      - AD469x_INx_REF_GND
      - AD469x_INx_COM
      - AD469x_INx_EVEN_ODD
  ch_sequence:
    type: int
    enum:
      - AD469x_single_cycle
      - AD469x_two_cycle
      - AD469x_standard_seq
      - AD469x_advanced_seq
  std_seq_osr:
    type: int
    enum:
      - AD469x_OSR_1
      - AD469x_OSR_4
      - AD469x_OSR_16
      - AD469x_OSR_64
  adv_seq_osr_resol[AD469x_CHANNEL_NO]:
    type: int
    enum:
      - AD469x_OSR_1
      - AD469x_OSR_4
      - AD469x_OSR_16
      - AD469x_OSR_64
  num_data_ch:
    type: uint8_t
  temp_enabled:
    type: bool
  enable_extended_init:
    type: bool
```

## binding_parser/dts/bindings/no-os-ad4858.yaml
```yaml
# Copyright (c) 2025 Analog Devices Inc.

description: No-os binding for ad4858 device

compatible: "adi,no-os-ad4858"

include: [spi-device.yaml, gpio-controller.yaml]

properties:
  prod_id:
    type: int
    enum:
      - AD4858_PROD_ID_L 
      - AD4857_PROD_ID_L 
      - AD4856_PROD_ID_L 
      - AD4855_PROD_ID_L 
      - AD4854_PROD_ID_L 
      - AD4853_PROD_ID_L 
      - AD4852_PROD_ID_L 
      - AD4851_PROD_ID_L 
      - AD4858I_PROD_ID_L 
  addr_ascension_enable:
    type: bool
  operating_mode:
    type: int
    enum:
      - AD4858_NORMAL_OP_MODE 
      - AD4858_LOW_POWER_OP_MODE 
      - AD4858_NUM_OF_OP_MODES 
  osr_enable:
    type: bool
  osr_ratio:
    type: int
    enum:
      - AD4858_OSR_2
      - AD4858_OSR_4
      - AD4858_OSR_8
      - AD4858_OSR_16
      - AD4858_OSR_32
      - AD4858_OSR_64
      - AD4858_OSR_128
      - AD4858_OSR_256
      - AD4858_OSR_512
      - AD4858_OSR_1024
      - AD4858_OSR_2048
      - AD4858_OSR_4096
      - AD4858_OSR_8192
      - AD4858_OSR_16384
      - AD4858_OSR_32768
      - AD4858_OSR_65536
      - AD4858_NUM_OF_OSR_RATIO
  packet_format:
    type: int
    enum:
      - AD4858_PACKET_16_BIT
      - AD4858_PACKET_20_BIT
      - AD4858_PACKET_24_BIT
      - AD4858_PACKET_32_BIT
  test_pattern:
    type: bool
  use_default_chn_configs:
    type: bool
  chn_softspan[AD4858_NUM_CHANNELS]:
    type: int
    enum:
      - AD4858_RANGE_0V_TO_2_5V
      - AD4858_RANGE_NEG_2_5V_TO_POS_2_5V
      - AD4858_RANGE_0V_TO_5_0V
      - AD4858_RANGE_NEG_5_0V_TO_POS_5_0V
      - AD4858_RANGE_0V_TO_6_25V
      - AD4858_RANGE_NEG_6_25V_TO_POS_6_25V
      - AD4858_RANGE_0V_TO_10_0V
      - AD4858_RANGE_NEG_10_0V_TO_POS_10_0V
      - AD4858_RANGE_0V_TO_12_5V
      - AD4858_RANGE_NEG_12_5V_TO_POS_12_5V
      - AD4858_RANGE_0V_TO_20_0V
      - AD4858_RANGE_NEG_20_0V_TO_POS_20_0V
      - AD4858_RANGE_0V_TO_25_0V
      - AD4858_RANGE_NEG_25_0V_TO_POS_25_0V
      - AD4858_RANGE_0V_TO_40_0V
      - AD4858_RANGE_NEG_40_0V_TO_POS_40_0V
      - AD4858_NUM_OF_SOFTSPAN
  chn_offset[AD4858_NUM_CHANNELS]:
    type: uint32_t
  chn_gain[AD4858_NUM_CHANNELS]:
    type: uint16_t
  chn_phase[AD4858_NUM_CHANNELS]:
    type: uint16_t
  chn_or[AD4858_NUM_CHANNELS]:
    type: uint16_t
  chn_ur[AD4858_NUM_CHANNELS]:
    type: uint16_t
  chn_sleep_value[AD4858_NUM_CHANNELS]:
    type: int
    enum:
      - AD4858_SLEEP_DISABLE
      - AD4858_SLEEP_ENABLE
  chn_seamless_hdr[AD4858_NUM_CHANNELS]:
    type: int
    enum:
      - AD4858_SEAMLESS_HDR_DISABLE
      - AD4858_SEAMLESS_HDR_ENABLE
```

## binding_parser/dts/bindings/no-os-ad5110.yaml
```yaml
# Copyright (c) 2025 Analog Devices Inc.

description: No-os binding for ad5110 device

compatible: "adi,no-os-ad5110"

include: [i2c-device.yaml]

properties:
  ad5110_dev_addr:
    type: uint8_t
```

## binding_parser/dts/bindings/no-os-ad525x.yaml
```yaml
# Copyright (c) 2025 Analog Devices Inc.

description: No-os binding for ad525x device

compatible: "adi,no-os-ad525x"

include: [spi-device.yaml, i2c-device.yaml, gpio-controller.yaml]

properties:
  this_device:
    type: int
    enum:
      - ID_AD5232
      - ID_AD5235
      - ID_ADN2850
      - ID_AD5252
      - ID_AD5251
      - ID_AD5254
      - ID_AD5253
```

## binding_parser/dts/bindings/no-os-ad5293.yaml
```yaml
# Copyright (c) 2025 Analog Devices Inc.

description: No-os binding for ad5293 device

compatible: "adi,no-os-ad5293"

include: [spi-device.yaml, gpio-controller.yaml]

properties:
  chip_num:
    type: uint16_t
```

## binding_parser/dts/bindings/no-os-ad5421.yaml
```yaml
# Copyright (c) 2025 Analog Devices Inc.

description: No-os binding for ad5421 device

compatible: "adi,no-os-ad5421"

include: [spi-device.yaml, gpio-controller.yaml]

properties:
```

## binding_parser/dts/bindings/no-os-ad5446.yaml
```yaml
# Copyright (c) 2025 Analog Devices Inc.

description: No-os binding for ad5446 device

compatible: "adi,no-os-ad5446"

include: [spi-device.yaml, gpio-controller.yaml]

properties:
  act_device:
    type: int
    enum:
      - ID_AD5600
      - ID_AD5553
      - ID_AD5543
      - ID_AD5542A
      - ID_AD5541A
      - ID_AD5512A
      - ID_AD5453
      - ID_AD5452
      - ID_AD5451
      - ID_AD5450
      - ID_AD5446
      - ID_AD5444
```
