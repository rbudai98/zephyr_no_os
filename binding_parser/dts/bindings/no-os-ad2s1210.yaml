## binding_parser/dts/bindings/no-os-ad5449.yaml
```yaml
# Copyright (c) 2025 Analog Devices Inc.

description: No-os binding for ad5449 device

compatible: "adi,no-os-ad5449"

include: [spi-device.yaml, gpio-controller.yaml]

properties:
  act_device:
    type: int
    enum:
      - ID_AD5415
      - ID_AD5426
      - ID_AD5429
      - ID_AD5432
      - ID_AD5439
      - ID_AD5443
      - ID_AD5449
```

## binding_parser/dts/bindings/no-os-ad5460.yaml
```yaml
# Copyright (c) 2025 Analog Devices Inc.

description: No-os binding for ad5460 device

compatible: "adi,no-os-ad5460"

include: [spi-device.yaml, gpio-controller.yaml]

properties:
  dev_addr:
    type: uint8_t
```

## binding_parser/dts/bindings/no-os-ad5592r.yaml
```yaml
# Copyright (c) 2025 Analog Devices Inc.

description: No-os binding for ad5592r device

compatible: "adi,no-os-ad5592r"

include: [spi-device.yaml, i2c-device.yaml]

properties:
  int_ref:
    type: bool
  channel_modes[8]:
    type: uint8_t
  channel_offstate[8]:
    type: uint8_t
  adc_range:
    type: int
    enum:
      - ZERO_TO_VREF
      - ZERO_TO_2VREF
  dac_range:
    type: int
    enum:
      - ZERO_TO_VREF
      - ZERO_TO_2VREF
  adc_buf:
    type: bool
  power_down[8]:
    type: uint8_t
```

## binding_parser/dts/bindings/no-os-ad5628.yaml
```yaml
# Copyright (c) 2025 Analog Devices Inc.

description: No-os binding for ad5628 device

compatible: "adi,no-os-ad5628"

include: [spi-device.yaml]

properties:
```

## binding_parser/dts/bindings/no-os-ad5629r.yaml
```yaml
# Copyright (c) 2025 Analog Devices Inc.

description: No-os binding for ad5629r device

compatible: "adi,no-os-ad5629r"

include: [spi-device.yaml, i2c-device.yaml, gpio-controller.yaml]

properties:
  act_device:
    type: int
    enum:
      - ID_AD5629R
      - ID_AD5669R
      - ID_AD5668
      - ID_AD5648
      - ID_AD5628
```

## binding_parser/dts/bindings/no-os-ad5686.yaml
```yaml
# Copyright (c) 2025 Analog Devices Inc.

description: No-os binding for ad5686 device

compatible: "adi,no-os-ad5686"

include: [spi-device.yaml, i2c-device.yaml, gpio-controller.yaml]

properties:
  act_device:
    type: int
    enum:
      - ID_AD5671R
      - ID_AD5672R
      - ID_AD5673R
      - ID_AD5674
      - ID_AD5674R
      - ID_AD5675R
      - ID_AD5676
      - ID_AD5676R
      - ID_AD5677R
      - ID_AD5679
      - ID_AD5679R
      - ID_AD5686
      - ID_AD5684R
      - ID_AD5685R
      - ID_AD5686R
      - ID_AD5687
      - ID_AD5687R
      - ID_AD5689
      - ID_AD5689R
      - ID_AD5697R
      - ID_AD5694
      - ID_AD5694R
      - ID_AD5695R
      - ID_AD5696
      - ID_AD5696R
      - ID_AD5681R
      - ID_AD5682R
      - ID_AD5683R
      - ID_AD5683
      - ID_AD5691R
      - ID_AD5692R
      - ID_AD5693R
      - ID_AD5693
```

## binding_parser/dts/bindings/no-os-ad5754r.yaml
```yaml
# Copyright (c) 2025 Analog Devices Inc.

description: No-os binding for ad5754r device

compatible: "adi,no-os-ad5754r"

include: [spi-device.yaml, gpio-controller.yaml]

properties:
  dac_ch_range[AD5754R_NUM_CHANNELS]:
    type: int
    enum:
      - AD5754R_SPAN_0V_TO_5V
      - AD5754R_SPAN_0V_TO_10V
      - AD5754R_SPAN_0V_TO_10V8
      - AD5754R_SPAN_M5V_TO_5V
      - AD5754R_SPAN_M10V_TO_10V
      - AD5754R_SPAN_M10V8_TO_10V8
  clamp_en:
    type: int
    enum:
      - AD5754R_CTRL_CLAMP_DIS
      - AD5754R_CTRL_CLAMP_EN
  tsd_en:
    type: int
    enum:
      - AD5754R_CTRL_TSD_DIS
      - AD5754R_CTRL_TSD_EN
  clear_sel:
    type: int
    enum:
      - AD5754R_CTRL_CLEAR_0V
      - AD5754R_CTRL_CLEAR_MIDSCALE_CODE
  sdo_dis:
    type: int
    enum:
      - AD5754R_CTRL_SDO_EN
      - AD5754R_CTRL_SDO_DIS
  dac_ch_pwr_states[AD5754R_NUM_CHANNELS]:
    type: int
    enum:
      - AD5754R_PWR_DAC_CH_POWERDOWN
      - AD5754R_PWR_DAC_CH_POWERUP
  int_ref_pwrup:
    type: int
    enum:
      - AD5754R_PWR_INT_REF_POWERDOWN
      - AD5754R_PWR_INT_REF_POWERUP
  encoding:
    type: int
    enum:
      - AD5754R_ENCODING_TWOSCOMPLEMENT
      - AD5754R_ENCODING_BINARY
  vref_mv:
    type: uint16_t
```

## binding_parser/dts/bindings/no-os-ad5755.yaml
```yaml
# Copyright (c) 2025 Analog Devices Inc.

description: No-os binding for ad5755 device

compatible: "adi,no-os-ad5755"

include: [spi-device.yaml, gpio-controller.yaml]

properties:
  this_device:
    type: int
    enum:
      - ID_AD5755
      - ID_AD5755_1
      - ID_AD5757
```
