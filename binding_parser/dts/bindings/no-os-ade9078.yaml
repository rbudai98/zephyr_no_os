## binding_parser/dts/bindings/no-os-ade9078.yaml
```yaml
# Copyright (c) 2025 Analog Devices Inc.

description: No-os binding for ade9078 device

compatible: "adi,no-os-ade9078"

include: [spi-device.yaml]

properties:
  power_mode:
    type: uint8_t
```

## binding_parser/dts/bindings/no-os-ade9113.yaml
```yaml
# Copyright (c) 2025 Analog Devices Inc.

description: No-os binding for ade9113 device

compatible: "adi,no-os-ade9113"

include: [spi-device.yaml, gpio-controller.yaml]

properties:
  no_devs:
    type: uint8_t
```

## binding_parser/dts/bindings/no-os-ade9153a.yaml
```yaml
# Copyright (c) 2025 Analog Devices Inc.

description: No-os binding for ade9153a device

compatible: "adi,no-os-ade9153a"

include: [spi-device.yaml, gpio-controller.yaml]

properties:
  spi_en:
    type: uint8_t
  ai_swap:
    type: uint8_t
  ai_pga_gain:
    type: int
    enum:
      - ADE9153A_AI_GAIN_16 
      - ADE9153A_AI_GAIN_24 
      - ADE9153A_AI_GAIN_32 
      - ADE9153A_AI_GAIN_38_4 
  hpf_crn:
    type: int
    enum:
      - ADE9153A_HPF_CORNER_38_695_HZ
      - ADE9153A_HPF_CORNER_19_6375_HZ
      - ADE9153A_HPF_CORNER_9_895_HZ
      - ADE9153A_HPF_CORNER_4_9675_HZ
      - ADE9153A_HPF_CORNER_2_49_HZ
      - ADE9153A_HPF_CORNER_1_2475_HZ
      - ADE9153A_HPF_CORNER_0_625_HZ
      - ADE9153A_HPF_CORNER_0_3125_HZ
  freq:
    type: int
    enum:
      - F_50_HZ
      - F_60_HZ
  vlevel:
    type: uint32_t
  rsmall:
    type: uint32_t
  no_samples:
    type: uint32_t
  ai_gain:
    type: uint32_t
```

## binding_parser/dts/bindings/no-os-ade9430.yaml
```yaml
# Copyright (c) 2025 Analog Devices Inc.

description: No-os binding for ade9430 device

compatible: "adi,no-os-ade9430"

include: [spi-device.yaml]

properties:
  temp_en:
    type: bool
```

## binding_parser/dts/bindings/no-os-ades1754.yaml
```yaml
# Copyright (c) 2025 Analog Devices Inc.

description: No-os binding for ades1754 device

compatible: "adi,no-os-ades1754"


properties:
  id:
    type: int
    enum:
      - ID_ADES1754
      - ID_ADES1755
      - ID_ADES1756
      - ID_ADES1751
      - ID_ADES1752
  uart_bridge:
    type: bool
  dev_addr:
    type: uint8_t
  no_dev:
    type: uint8_t
```

## binding_parser/dts/bindings/no-os-adf4106.yaml
```yaml
# Copyright (c) 2025 Analog Devices Inc.

description: No-os binding for adf4106 device

compatible: "adi,no-os-adf4106"

include: [spi-device.yaml, gpio-controller.yaml]

properties:
  this_device:
    type: int
    enum:
      - ID_ADF4001
      - ID_ADF4002
      - ID_ADF4106
  init_method:
    type: int
    enum:
      - INIT_LATCH
      - INIT_CEPIN
      - INIT_COUNTER_RESET
```

## binding_parser/dts/bindings/no-os-adf4153.yaml
```yaml
# Copyright (c) 2025 Analog Devices Inc.

description: No-os binding for adf4153 device

compatible: "adi,no-os-adf4153"

include: [spi-device.yaml, gpio-controller.yaml]

properties:
```

## binding_parser/dts/bindings/no-os-adf4156.yaml
```yaml
# Copyright (c) 2025 Analog Devices Inc.

description: No-os binding for adf4156 device

compatible: "adi,no-os-adf4156"

include: [spi-device.yaml, gpio-controller.yaml]

properties:
```

## binding_parser/dts/bindings/no-os-adf4157.yaml
```yaml
# Copyright (c) 2025 Analog Devices Inc.

description: No-os binding for adf4157 device

compatible: "adi,no-os-adf4157"

include: [spi-device.yaml, gpio-controller.yaml]

properties:
```

## binding_parser/dts/bindings/no-os-adf4368.yaml
```yaml
# Copyright (c) 2025 Analog Devices Inc.

description: No-os binding for adf4368 device

compatible: "adi,no-os-adf4368"

include: [spi-device.yaml]

properties:
  spi_4wire_en:
    type: bool
  cmos_3v3:
    type: bool
  ref_doubler_en:
    type: bool
  ref_div:
    type: uint8_t
  cp_i:
    type: uint8_t
  ld_count:
    type: uint8_t
  ref_freq_hz:
    type: uint64_t
  freq:
    type: uint64_t
```

## binding_parser/dts/bindings/no-os-adf4368_iio_dev.yaml
```yaml
# Copyright (c) 2025 Analog Devices Inc.

description: No-os binding for adf4368_iio_dev device

compatible: "adi,no-os-adf4368_iio_dev"


properties:
```

## binding_parser/dts/bindings/no-os-adf4371.yaml
```yaml
# Copyright (c) 2025 Analog Devices Inc.

description: No-os binding for adf4371 device

compatible: "adi,no-os-adf4371"

include: [spi-device.yaml]

properties:
  spi_3wire_enable:
    type: bool
  clkin_frequency:
    type: uint32_t
  differential_ref_clock:
    type: bool
  loop_filter_inverting:
    type: bool
  charge_pump_microamp:
    type: uint32_t
  mute_till_lock_enable:
    type: bool
  muxout_select:
    type: uint32_t
  muxout_level_1v8_enable:
    type: bool
  num_channels:
    type: uint32_t
```

## binding_parser/dts/bindings/no-os-adf4377.yaml
```yaml
# Copyright (c) 2025 Analog Devices Inc.

description: No-os binding for adf4377 device

compatible: "adi,no-os-adf4377"

include: [spi-device.yaml, gpio-controller.yaml]

properties:
  dev_id:
    type: int
    enum:
      - ADF4377 
      - ADF4378 
  spi4wire:
    type: bool
  clkin_freq:
    type: uint32_t
  f_clk:
    type: uint64_t
  cp_i:
    type: uint8_t
  muxout_select:
    type: uint32_t
  ref_doubler_en:
    type: uint8_t
  clkout_op:
    type: uint8_t
```

## binding_parser/dts/bindings/no-os-adf4382.yaml
```yaml
# Copyright (c) 2025 Analog Devices Inc.

description: No-os binding for adf4382 device

compatible: "adi,no-os-adf4382"

include: [spi-device.yaml]

properties:
  spi_3wire_en:
    type: bool
  cmos_3v3:
    type: bool
  ref_freq_hz:
    type: uint64_t
  freq:
    type: uint64_t
  ref_doubler_en:
    type: bool
  ref_div:
    type: uint8_t
  cp_i:
    type: uint8_t
  bleed_word:
    type: uint16_t
  ld_count:
    type: uint8_t
  en_lut_gen:
    type: uint8_t
  en_lut_cal:
    type: uint8_t
  id:
    type: int
    enum:
      - ID_ADF4382
      - ID_ADF4382A
      - ID_ADF4383
```

## binding_parser/dts/bindings/no-os-adf4382_iio_dev.yaml
```yaml
# Copyright (c) 2025 Analog Devices Inc.

description: No-os binding for adf4382_iio_dev device

compatible: "adi,no-os-adf4382_iio_dev"


properties:
```

## binding_parser/dts/bindings/no-os-adf5355.yaml
```yaml
# Copyright (c) 2025 Analog Devices Inc.

description: No-os binding for adf5355 device

compatible: "adi,no-os-adf5355"

include: [spi-device.yaml]

properties:
  dev_id:
    type: int
    enum:
      - ADF5355
      - ADF4355
      - ADF4355_2
      - ADF4355_3
      - ADF4356
      - ADF5356
  freq_req:
    type: uint64_t
  freq_req_chan:
    type: uint8_t
  clkin_freq:
    type: uint32_t
  cp_ua:
    type: uint32_t
  cp_neg_bleed_en:
    type: bool
  cp_gated_bleed_en:
    type: bool
  cp_bleed_current_polarity_en:
    type: bool
  mute_till_lock_en:
    type: bool
  outa_en:
    type: bool
  outb_en:
    type: bool
  outa_power:
    type: uint8_t
  outb_power:
    type: uint8_t
  phase_detector_polarity_neg:
    type: bool
  ref_diff_en:
    type: bool
  mux_out_3v3_en:
    type: bool
  ref_doubler_en:
    type: uint8_t
  ref_div2_en:
    type: uint8_t
  mux_out_sel:
    type: int
    enum:
      - ADF5355_MUXOUT_THREESTATE
      - ADF5355_MUXOUT_DVDD
      - ADF5355_MUXOUT_GND
      - ADF5355_MUXOUT_R_DIV_OUT
      - ADF5355_MUXOUT_N_DIV_OUT
      - ADF5355_MUXOUT_ANALOG_LOCK_DETECT
      - ADF5355_MUXOUT_DIGITAL_LOCK_DETECT
  outb_sel_fund:
    type: bool
```

## binding_parser/dts/bindings/no-os-adf5611.yaml
```yaml
# Copyright (c) 2025 Analog Devices Inc.

description: No-os binding for adf5611 device

compatible: "adi,no-os-adf5611"

include: [spi-device.yaml]

properties:
  spi4wire:
    type: bool
  cmos_3v3:
    type: bool
  ref_clk_freq:
    type: uint64_t
  rfout_freq:
    type: uint64_t
  ref_div:
    type: uint8_t
  cp_i:
    type: uint8_t
  bleed_word:
    type: uint16_t
  ld_count:
    type: uint8_t
  rfoutdiv_div:
    type: uint8_t
  id:
    type: int
    enum:
      - ID_ADF5611
      - ID_ADF5612
```

## binding_parser/dts/bindings/no-os-adf5611_iio_dev.yaml
```yaml
# Copyright (c) 2025 Analog Devices Inc.

description: No-os binding for adf5611_iio_dev device

compatible: "adi,no-os-adf5611_iio_dev"


properties:
```

## binding_parser/dts/bindings/no-os-adf5902.yaml
```yaml
# Copyright (c) 2025 Analog Devices Inc.

description: No-os binding for adf5902 device

compatible: "adi,no-os-adf5902"

include: [spi-device.yaml, gpio-controller.yaml]

properties:
  ref_in:
    type: uint64_t
  rf_out:
    type: uint64_t
  ref_doubler_en:
    type: uint8_t
  ref_div2_en:
    type: uint8_t
  adc_avg:
    type: uint8_t
  tx_amp_cal_ref:
    type: uint8_t
  ramp_delay_en:
    type: uint8_t
  tx_trig_en:
    type: uint8_t
  delay_words_no:
    type: uint8_t
  delay_wd[ADF5902_MAX_DELAY_WORD_NO]:
    type: uint16_t
  slopes_no:
    type: uint8_t
  tx_ramp_clk:
    type: uint8_t
  tx_data_invert:
    type: uint8_t
  ramp_status:
    type: uint16_t
  clk1_div_ramp:
    type: uint16_t
  clk2_div_no:
    type: uint8_t
  clk2_div[ADF5902_MAX_CLK2_DIV_NO]:
    type: uint16_t
  le_sel:
    type: uint8_t
  clk_div_mode:
    type: uint8_t
  cp_current:
    type: uint8_t
  cp_tristate_en:
    type: uint8_t
  ramp_mode:
    type: uint8_t
```

## binding_parser/dts/bindings/no-os-adf7023.yaml
```yaml
# Copyright (c) 2025 Analog Devices Inc.

description: No-os binding for adf7023 device

compatible: "adi,no-os-adf7023"

include: [spi-device.yaml, gpio-controller.yaml]

properties:
```

## binding_parser/dts/bindings/no-os-adgs1408.yaml
```yaml
# Copyright (c) 2025 Analog Devices Inc.

description: No-os binding for adgs1408 device

compatible: "adi,no-os-adgs1408"

include: [spi-device.yaml]

properties:
  crc_en:
    type: int
    enum:
      - ADGS1408_ENABLE
      - ADGS1408_DISABLE
  burst_mode_en:
    type: int
    enum:
      - ADGS1408_ENABLE
      - ADGS1408_DISABLE
  daisy_chain_en:
    type: int
    enum:
      - ADGS1408_ENABLE
      - ADGS1408_DISABLE
  round_robin_en:
    type: int
    enum:
      - ADGS1408_ENABLE
      - ADGS1408_DISABLE
  act_device:
    type: int
    enum:
      - ID_ADGS1408
      - ID_ADGS1409
```

## binding_parser/dts/bindings/no-os-adin1110.yaml
```yaml
# Copyright (c) 2025 Analog Devices Inc.

description: No-os binding for adin1110 device

compatible: "adi,no-os-adin1110"

include: [spi-device.yaml, gpio-controller.yaml]

properties:
  chip_type:
    type: int
    enum:
      - ADIN1110
      - ADIN2111
  mac_address[ADIN1110_ETH_ALEN]:
    type: uint8_t
  append_crc:
    type: bool
```

## binding_parser/dts/bindings/no-os-adin1300.yaml
```yaml
# Copyright (c) 2025 Analog Devices Inc.

description: No-os binding for adin1300 device

compatible: "adi,no-os-adin1300"

include: [gpio-controller.yaml]

properties:
  gp_clk:
    type: bool
  gp_clk_source:
    type: int
    enum:
      - ADIN1300_GP_CLK_REFERENCE
      - ADIN1300_GP_CLK_HEARTBEAT_FREE
      - ADIN1300_GP_CLK_HEARTBEAT_RECOVERED
      - ADIN1300_GP_CLK_FREE 
      - ADIN1300_GP_CLK_RECOVERED
  clk25_ref:
    type: bool
  speed_cap:
    type: int
    enum:
      - ADIN1300_10_BASE_T_HALFDUPLEX
      - ADIN1300_10_BASE_T_FULLDUPLEX
      - ADIN1300_100_BASE_TX_HALFDUPLEX
      - ADIN1300_100_BASE_TX_FULLDUPLEX
      - ADIN1300_1000_BASE_T_HALFDUPLEX
      - ADIN1300_1000_BASE_T_FULLDUPLEX
  autoneg:
    type: bool
```

## binding_parser/dts/bindings/no-os-adin1300_iio.yaml
```yaml
# Copyright (c) 2025 Analog Devices Inc.

description: No-os binding for adin1300_iio device

compatible: "adi,no-os-adin1300_iio"


properties:
```

## binding_parser/dts/bindings/no-os-adis.yaml
```yaml
# Copyright (c) 2025 Analog Devices Inc.

description: No-os binding for adis device

compatible: "adi,no-os-adis"

include: [spi-device.yaml, gpio-controller.yaml]

properties:
  ext_clk:
    type: uint32_t
  sync_mode:
    type: uint32_t
  dev_id:
    type: int
    enum:
      - ADIS16465_1
      - ADIS16465_2
      - ADIS16465_3
      - ADIS16467_1
      - ADIS16467_2
      - ADIS16467_3
      - ADIS16470
      - ADIS16475_1
      - ADIS16475_2
      - ADIS16475_3
      - ADIS16477_1
      - ADIS16477_2
      - ADIS16477_3
      - ADIS16500
      - ADIS16501
      - ADIS16505_1
      - ADIS16505_2
      - ADIS16505_3
      - ADIS16507_1
      - ADIS16507_2
      - ADIS16507_3
      - ADIS16545_1
      - ADIS16545_2
      - ADIS16545_3
      - ADIS16547_1
      - ADIS16547_2
      - ADIS16547_3
      - ADIS16550
      - ADIS16575_2
      - ADIS16575_3
      - ADIS16576_2
      - ADIS16576_3
      - ADIS16577_2
      - ADIS16577_3
```
