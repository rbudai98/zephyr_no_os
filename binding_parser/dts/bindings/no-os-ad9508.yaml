## binding_parser/dts/bindings/no-os-ad9508.yaml
```yaml
# Copyright (c) 2025 Analog Devices Inc.

description: No-os binding for ad9508 device

compatible: "adi,no-os-ad9508"

include: [spi-device.yaml]

properties:
```

## binding_parser/dts/bindings/no-os-ad9517.yaml
```yaml
# Copyright (c) 2025 Analog Devices Inc.

description: No-os binding for ad9517 device

compatible: "adi,no-os-ad9517"

include: [spi-device.yaml]

properties:
  ad9517_type:
    type: int
    enum:
      - AD9517_1 
      - AD9517_2 
      - AD9517_3 
      - AD9517_4 
```

## binding_parser/dts/bindings/no-os-ad9523.yaml
```yaml
# Copyright (c) 2025 Analog Devices Inc.

description: No-os binding for ad9523 device

compatible: "adi,no-os-ad9523"

include: [spi-device.yaml]

properties:
```

## binding_parser/dts/bindings/no-os-ad9528.yaml
```yaml
# Copyright (c) 2025 Analog Devices Inc.

description: No-os binding for ad9528 device

compatible: "adi,no-os-ad9528"

include: [spi-device.yaml, gpio-controller.yaml]

properties:
  export_no_os_clk:
    type: bool
```

## binding_parser/dts/bindings/no-os-ad9545.yaml
```yaml
# Copyright (c) 2025 Analog Devices Inc.

description: No-os binding for ad9545 device

compatible: "adi,no-os-ad9545"

include: [spi-device.yaml, i2c-device.yaml]

properties:
  comm_type:
    type: int
    enum:
      - SPI
      - I2C
```

## binding_parser/dts/bindings/no-os-ad9553.yaml
```yaml
# Copyright (c) 2025 Analog Devices Inc.

description: No-os binding for ad9553 device

compatible: "adi,no-os-ad9553"

include: [spi-device.yaml]

properties:
```

## binding_parser/dts/bindings/no-os-ad9625.yaml
```yaml
# Copyright (c) 2025 Analog Devices Inc.

description: No-os binding for ad9625 device

compatible: "adi,no-os-ad9625"

include: [spi-device.yaml]

properties:
  lane_rate_kbps:
    type: uint32_t
  test_samples[4]:
    type: uint32_t
```

## binding_parser/dts/bindings/no-os-ad9656.yaml
```yaml
# Copyright (c) 2025 Analog Devices Inc.

description: No-os binding for ad9656 device

compatible: "adi,no-os-ad9656"

include: [spi-device.yaml]

properties:
  lane_rate_kbps:
    type: uint32_t
```

## binding_parser/dts/bindings/no-os-ad9680.yaml
```yaml
# Copyright (c) 2025 Analog Devices Inc.

description: No-os binding for ad9680 device

compatible: "adi,no-os-ad9680"

include: [spi-device.yaml]

properties:
  lane_rate_kbps:
    type: uint32_t
  sampling_frequency_hz:
    type: unsigned long long
  dcm:
    type: unsigned long
  sysref_mode:
    type: unsigned long
```

## binding_parser/dts/bindings/no-os-ad9739a.yaml
```yaml
# Copyright (c) 2025 Analog Devices Inc.

description: No-os binding for ad9739a device

compatible: "adi,no-os-ad9739a"

include: [spi-device.yaml]

properties:
  common_mode_voltage_dacclk_p:
    type: uint8_t
  common_mode_voltage_dacclk_n:
    type: uint8_t
  full_scale_current:
    type: float
```

## binding_parser/dts/bindings/no-os-ad9833.yaml
```yaml
# Copyright (c) 2025 Analog Devices Inc.

description: No-os binding for ad9833 device

compatible: "adi,no-os-ad9833"

include: [spi-device.yaml, gpio-controller.yaml]

properties:
  act_device:
    type: int
    enum:
      - ID_AD9833
      - ID_AD9834
      - ID_AD9837
      - ID_AD9838
```

## binding_parser/dts/bindings/no-os-ada4250.yaml
```yaml
# Copyright (c) 2025 Analog Devices Inc.

description: No-os binding for ada4250 device

compatible: "adi,no-os-ada4250"

include: [spi-device.yaml, gpio-controller.yaml]

properties:
  device_id:
    type: int
    enum:
      - ADA4230
      - ADA4250
  avdd_v:
    type: int32_t
  refbuf_en:
    type: bool
  gain:
    type: int
    enum:
      - ADA4250_GAIN_1
      - ADA4250_GAIN_2
      - ADA4250_GAIN_4
      - ADA4250_GAIN_8
      - ADA4250_GAIN_16
      - ADA4250_GAIN_32
      - ADA4250_GAIN_64
      - ADA4250_GAIN_128
  bias:
    type: int
    enum:
      - ADA4250_BIAS_DISABLE
      - ADA4250_BIAS_BANDGAP_REF
      - ADA4250_BIAS_AVDD
  bandwidth:
    type: int
    enum:
      - ADA4250_BANDWIDTH_LOW
      - ADA4250_BANDWIDTH_HIGH
  offset_nv:
    type: int32_t
```

## binding_parser/dts/bindings/no-os-adaq7980.yaml
```yaml
# Copyright (c) 2025 Analog Devices Inc.

description: No-os binding for adaq7980 device

compatible: "adi,no-os-adaq7980"

include: [spi-device.yaml, gpio-controller.yaml]

properties:
```

## binding_parser/dts/bindings/no-os-adaq8092.yaml
```yaml
# Copyright (c) 2025 Analog Devices Inc.

description: No-os binding for adaq8092 device

compatible: "adi,no-os-adaq8092"

include: [spi-device.yaml, gpio-controller.yaml]

properties:
  pd_mode:
    type: int
    enum:
      - ADAQ8092_NORMAL_OP
      - ADAQ8092_CH1_NORMAL_CH2_NAP
      - ADAQ8092_CH1_CH2_NAP
      - ADAQ8092_SLEEP
  clk_pol_mode:
    type: int
    enum:
      - ADAQ8092_CLK_POL_NORMAL
      - ADAQ8092_CLK_POL_INVERTED
  clk_phase_mode:
    type: int
    enum:
      - ADAQ8092_NO_DELAY
      - ADAQ8092_CLKOUT_DELAY_45DEG
      - ADAQ8092_CLKOUT_DELAY_90DEG
      - ADAQ8092_CLKOUT_DELAY_180DEG
  clk_dc_mode:
    type: int
    enum:
      - ADAQ8092_CLK_DC_STABILIZER_OFF
      - ADAQ8092_CLK_DC_STABILIZER_ON
  lvds_cur_mode:
    type: int
    enum:
      - ADAQ8092_3M5A 
      - ADAQ8092_4MA 
      - ADAQ8092_4M5A 
      - ADAQ8092_3MA 
      - ADAQ8092_2M5A 
      - ADAQ8092_2M1A 
      - ADAQ8092_1M75 
  lvds_term_mode:
    type: int
    enum:
      - ADAQ8092_TERM_OFF
      - ADAQ8092_TERM_ON
  dout_en:
    type: int
    enum:
      - ADAQ8092_DOUT_ON
      - ADAQ8092_DOUT_OFF
  dout_mode:
    type: int
    enum:
      - ADAQ8092_FULL_RATE_CMOS
      - ADAQ8092_DOUBLE_RATE_LVDS
      - ADAQ8092_DOUBLE_RATE_CMOS
  test_mode:
    type: int
    enum:
      - ADAQ8092_TEST_OFF 
      - ADAQ8092_TEST_ONES 
      - ADAQ8092_TEST_ZEROS 
      - ADAQ8092_TEST_CHECKERBOARD 
      - ADAQ8092_TEST_ALTERNATING 
  alt_bit_pol_en:
    type: int
    enum:
      - ADAQ8092_ALT_BIT_POL_OFF
      - ADAQ8092_ALT_BIT_POL_ON
  data_rand_en:
    type: int
    enum:
      - ADAQ8092_DATA_RAND_OFF
      - ADAQ8092_DATA_RAND_ON
  twos_comp:
    type: int
    enum:
      - ADAQ8092_OFFSET_BINARY
      - ADAQ8092_TWOS_COMPLEMENT
```

## binding_parser/dts/bindings/no-os-adas1000.yaml
```yaml
# Copyright (c) 2025 Analog Devices Inc.

description: No-os binding for adas1000 device

compatible: "adi,no-os-adas1000"

include: [spi-device.yaml]

properties:
  frame_rate:
    type: uint32_t
```

## binding_parser/dts/bindings/no-os-adc_demo.yaml
```yaml
# Copyright (c) 2025 Analog Devices Inc.

description: No-os binding for adc_demo device

compatible: "adi,no-os-adc_demo"


properties:
  dev_global_attr:
    type: uint32_t
  dev_ch_attr[MAX_ADC_ADDR]:
    type: uint32_t
  ext_buff_len:
    type: uint32_t
```

## binding_parser/dts/bindings/no-os-ade7753.yaml
```yaml
# Copyright (c) 2025 Analog Devices Inc.

description: No-os binding for ade7753 device

compatible: "adi,no-os-ade7753"

include: [spi-device.yaml, gpio-controller.yaml]

properties:
```

## binding_parser/dts/bindings/no-os-ade7754.yaml
```yaml
# Copyright (c) 2025 Analog Devices Inc.

description: No-os binding for ade7754 device

compatible: "adi,no-os-ade7754"

include: [spi-device.yaml, gpio-controller.yaml]

properties:
```

## binding_parser/dts/bindings/no-os-ade7758.yaml
```yaml
# Copyright (c) 2025 Analog Devices Inc.

description: No-os binding for ade7758 device

compatible: "adi,no-os-ade7758"

include: [spi-device.yaml]

properties:
```

## binding_parser/dts/bindings/no-os-ade7816.yaml
```yaml
# Copyright (c) 2025 Analog Devices Inc.

description: No-os binding for ade7816 device

compatible: "adi,no-os-ade7816"

include: [spi-device.yaml, i2c-device.yaml, gpio-controller.yaml]

properties:
  active_irq:
    type: int
    enum:
      - ADE7816_NO_IRQ
      - ADE7816_IRQ0
      - ADE7816_IRQ1
      - ADE7816_IRQ0_IRQ1
  comm_type:
    type: int
    enum:
      - ADE7816_I2C
      - ADE7816_SPI
  irq0_priority:
    type: uint32_t
  irq1_priority:
    type: uint32_t
```

## binding_parser/dts/bindings/no-os-ade7880.yaml
```yaml
# Copyright (c) 2025 Analog Devices Inc.

description: No-os binding for ade7880 device

compatible: "adi,no-os-ade7880"

include: [spi-device.yaml]

properties:
  power_mode:
    type: uint8_t
```

## binding_parser/dts/bindings/no-os-ade7913.yaml
```yaml
# Copyright (c) 2025 Analog Devices Inc.

description: No-os binding for ade7913 device

compatible: "adi,no-os-ade7913"

include: [spi-device.yaml]

properties:
  no_devs:
    type: uint8_t
  burst_mode:
    type: uint8_t
```

## binding_parser/dts/bindings/no-os-ade7953.yaml
```yaml
# Copyright (c) 2025 Analog Devices Inc.

description: No-os binding for ade7953 device

compatible: "adi,no-os-ade7953"

include: [spi-device.yaml, gpio-controller.yaml]

properties:
  en_24_bit:
    type: uint8_t
```

## binding_parser/dts/bindings/no-os-ade7978.yaml
```yaml
# Copyright (c) 2025 Analog Devices Inc.

description: No-os binding for ade7978 device

compatible: "adi,no-os-ade7978"

include: [spi-device.yaml]

properties:
  temp_en:
    type: uint8_t
```

## binding_parser/dts/bindings/no-os-ade9000.yaml
```yaml
# Copyright (c) 2025 Analog Devices Inc.

description: No-os binding for ade9000 device

compatible: "adi,no-os-ade9000"

include: [spi-device.yaml]

properties:
  temp_en:
    type: bool
```
