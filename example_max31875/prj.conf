## CMakeLists.txt
```
# SPDX-License-Identifier: Apache-2.0

cmake_minimum_required(VERSION 3.20.0)

# Disable dynamic memory allocation in no-os
add_definitions(-DNO_OS_DRIVER_DYNAMIC_ALLOC=1)

set(DTC_OVERLAY_FILE "${CMAKE_CURRENT_SOURCE_DIR}/overlay/max31875.overlay")

find_package(Zephyr REQUIRED HINTS $ENV{ZEPHYR_BASE})

project(TEST_DRIVER)
zephyr_include_directories($TOOLCHAIN_ROOT/drivers/gpio)

 
target_sources(app PRIVATE src/main.c)
```

## west.yml
```
# Copyright (c) 2025 Analog Devices, Inc.
# SPDX-License-Identifier: Apache-2.0

manifest:
  remotes:
    - name: zephyrproject-rtos
      url-base: https://github.com/zephyrproject-rtos
    - name: no-os
      url-base: https://github.com/analogdevicesinc/no-OS.git

  projects:
    - name: zephyr
      remote: zephyrproject-rtos
      revision: v4.0.0
      import:
        name-allowlist:
          - cmsis
    - name: no-os
      remote: no-os
      revision: HEAD~0
      path: no-os/

  self:
    path: adi-zephyr-sdk
```

## prj.conf
```kconfig
CONFIG_GPIO=y
CONFIG_SPI=y
CONFIG_I2C=y

# Log error and
CONFIG_LOG=n
CONFIG_LOG_DEFAULT_LEVEL=1
CONFIG_LOG_BACKEND_UART=n
CONFIG_UART_CONSOLE=y
CONFIG_SERIAL=y

CONFIG_USE_STM32_ASSERT=y
CONFIG_ASSERT=y
```

## dts/bindings/max31875._no_os_test.yaml
```yaml
# Copyright (c) 2023 Analog Devices Inc.
# SPDX-License-Identifier: Apache-2.0

description: ADXL366 3-axis nanopower accelerometer, accessed through SPI bus, with no-os driver

compatible: "adi,max31875_no_os_test"

include: i2c-device.yaml
```

## dts/bindings/max31875_no_os_test.yaml
```yaml
# Copyright (c) 2023 Analog Devices Inc.
# SPDX-License-Identifier: Apache-2.0

description: MAX31875 no-os device description

compatible: "adi,max31875_no_os_test"

include: i2c-device.yaml
```

## src/main.c
```c
/*
 * Copyright (c) 2012-2014 Wind River Systems, Inc.
 *
 * SPDX-License-Identifier: Apache-2.0
 */
#include <stdio.h>
#include <zephyr/kernel.h>
#include <zephyr/device.h>
#include <zephyr/devicetree.h>
#include <zephyr/drivers/sensor.h>
#include <zephyr/drivers/gpio.h>                                                                                                                                                     
#include <zephyr/drivers/spi.h>

#include <max31875.h>
#include <zephyr_i2c.h>


int main(void)
{
	int ret;

	// Initialization parameters
	struct zephyr_i2c_init_param zephyr_i2c_ip;
	struct no_os_i2c_init_param no_os_i2c_ip;
	struct max31875_init_param max31875_ip;

	// Device descriptors
	struct max31875_dev* max31875_desc_ptr;

	printk("Hello World! %s\n", CONFIG_BOARD_TARGET);
	
	struct i2c_dt_spec TEST_DEVICE_FULL = I2C_DT_SPEC_GET(DT_NODELABEL(max31875));

	printk("I2C device addr: %d\n", TEST_DEVICE_FULL.addr);

	// zephyr IP
	zephyr_i2c_ip.i2c_desc = &TEST_DEVICE_FULL;

	// no os IP
	no_os_i2c_ip.extra = &zephyr_i2c_ip;
	no_os_i2c_ip.platform_ops = &zephyr_i2c_ops;
	no_os_i2c_ip.device_id = 1;

	// max31875 ip
	max31875_ip.i2c_init = no_os_i2c_ip;

	ret = max31875_init(&max31875_desc_ptr, &max31875_ip);
	printk("Max31875 init ret: %d\n", ret);

	uint32_t configBuff = 0b0000001000010000;

	ret = max31875_reg_write(max31875_desc_ptr, MAX31875_CONFIGURATION_REG, configBuff);
	if (ret)
	{
		printk("Max31875 reg config set ret: %d\n", ret);
		return ret;
	}
	int32_t val_tmp;
	while (1)
	{
		ret = max31875_reg_read(max31875_desc_ptr, MAX31875_TEMPERATURE_REG, &val_tmp);
		if (ret)
		{
			printk("Max31875 reg read ret: %d\n", ret);
			return ret;
		}
		printk("Temperature: %d\n", (val_tmp >> 8));
	}
	return 0;
}
```
